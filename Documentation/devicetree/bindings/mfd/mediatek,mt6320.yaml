## Documentation/devicetree/bindings/regulator/mediatek,mt6320-regulator.yaml
```yaml
# SPDX-License-Identifier: (GPL-2.0-only OR BSD-2-Clause)
%YAML 1.2
---
$id: http://devicetree.org/schemas/regulator/mediatek,mt6320-regulator.yaml#
$schema: http://devicetree.org/meta-schemas/core.yaml#

title: MediaTek MT6320 Regulator

maintainers:
  - Akari Tsuyukusa <akkun11.open@gmail.com>

description:
  Regulator function of the MT6320 PMIC.  The regulators are children
  of the "regulators" node; each child carries the standard regulator
  properties.

properties:
  compatible:
    const: mediatek,mt6320-regulator

patternProperties:
  "^(buck_vproc|buck_vsram|buck_vcore|buck_vm|buck_vio18|buck_vpa|buck_vrf18|buck_vrf18_2)$":
    type: object
    $ref: /schemas/regulator/regulator.yaml#
    unevaluatedProperties: false

  "^ldo_(vrf28|va|va28|vcama|vrf28_2|vtcxo|vtcxo_2|vmc1|vmch1|vemc_3v3|vemc_1v8|vgp1|vgp2|vgp3|vgp4|vgp5|vgp6|vsim1|vsim2|vibr|vast)$":
    type: object
    $ref: /schemas/regulator/regulator.yaml#
    unevaluatedProperties: false

required:
  - compatible

additionalProperties: false

examples:
  - |
    regulators {
        compatible = "mediatek,mt6320-regulator";

        buck_vproc {
            regulator-name = "vproc";
            regulator-min-microvolt = <700000>;
            regulator-max-microvolt = <1493750>;
        };

        ldo_vtcxo {
            regulator-name = "vtcxo";
            regulator-always-on;
        };
    };
```

## Documentation/devicetree/bindings/soc/mediatek/devapc.yaml
```yaml
# SPDX-License-Identifier: (GPL-2.0 OR BSD-2-Clause)
# # Copyright 2020 MediaTek Inc.
%YAML 1.2
---
$id: http://devicetree.org/schemas/soc/mediatek/devapc.yaml#
$schema: http://devicetree.org/meta-schemas/core.yaml#

title: MediaTek Device Access Permission Control driver

description: |
  MediaTek bus fabric provides TrustZone security support and data
  protection to prevent slaves from being accessed by unexpected masters.
  The security violation is logged and sent to the processor for further
  analysis and countermeasures.

maintainers:
  - Neal Liu <neal.liu@mediatek.com>

properties:
  compatible:
    enum:
      - mediatek,mt6779-devapc
      - mediatek,mt8186-devapc
      - mediatek,mt6589-devapc

  reg:
    description: |
      The base address of devapc register bank.

      MT6589 describes five independent instances, each as a pair of reg
      entries (an always-on permission window followed by a power-down
      violation window), so instance n uses reg entries 2n and 2n+1.
    maxItems: 10

  interrupts:
    description: A single interrupt specifier
    maxItems: 1

  clocks:
    description: Contains module clock source and clock names
    maxItems: 1

  clock-names:
    description: Names of the clocks list in clocks property
    maxItems: 1

  mediatek,devapc-forbid-slaves:
    description: |
      Permission policy: a flat list of 4-tuples that programs each named
      slave's access permission from the always-on window.

        <instance> <module> <domain-mask> <perm>

      domain-mask is a bitmask of the domain indices (1 = AP, 2 = MD1,
      4 = MD2, 8 = MM) and perm is 0..3, where 0 (L0) is no protection and
      3 (L3) forbids the access and raises a violation.  Slaves not listed
      stay at L0.

      This is entirely independent of mediatek,vio-irq-mask: a slave can be
      locked to L3 yet raise no interrupt.
    items:
      - description: DEVAPC instance index (0..4)
        maximum: 4
      - description: Slave module index within the instance
        maximum: 31
      - description: Bitmask of the domain masters to program
        minimum: 1
        maximum: 15
      - description: Permission level, 0 (L0) to 3 (L3)
        maximum: 3
    minItems: 4
    maxItems: 256

  mediatek,vio-irq-mask:
    description: |
      Interrupt-monitoring policy, independent of the permission policy.

      A non-zero value masks violation interrupts for every slave, so no
      DEVAPC interrupt is raised.  Violations are still latched in the
      D<d>_VIO_STA status registers and permissions still apply; only the
      notification is suppressed.

      A zero value (the default when this property is absent) unmasks
      violation interrupts for all slaves, so any violation is logged.

      Defaults to 0 (unmasked) when omitted.
    enum: [0, 1]

required:
  - compatible
  - reg
  - interrupts
  - clocks
  - clock-names

additionalProperties: false

examples:
  - |
    #include <dt-bindings/interrupt-controller/arm-gic.h>
    #include <dt-bindings/clock/mt6779-clk.h>

    devapc: devapc@10207000 {
      compatible = "mediatek,mt6779-devapc";
      reg = <0x10207000 0x1000>;
      interrupts = <GIC_SPI 168 IRQ_TYPE_LEVEL_LOW>;
      clocks = <&infracfg_ao CLK_INFRA_DEVICE_APC>;
      clock-names = "devapc-infra-clock";
    };

  - |
    #include <dt-bindings/interrupt-controller/arm-gic.h>
    #include <dt-bindings/clock/mt6589-clk.h>

    devapc: devapc@10010000 {
      compatible = "mediatek,mt6589-devapc";
      reg = <0x10010000 0x100>, <0x10207000 0x100>,
            <0x10010100 0x100>, <0x10207100 0x100>,
            <0x10010200 0x100>, <0x10207200 0x100>,
            <0x10010300 0x100>, <0x10207300 0x100>,
            <0x10010400 0x100>, <0x10207400 0x100>;
      interrupts = <GIC_SPI 94 IRQ_TYPE_LEVEL_LOW>;
      clocks = <&infracfg CLK_INFRA_DEVAPC>;
      clock-names = "devapc-infra-clock";

      /* Lock modules 1 and 2 of instance 0 to L3 for the MD domains. */
      mediatek,devapc-forbid-slaves = <0 1 0x6 0x3>,
                                      <0 2 0x6 0x3>;

      /* Default: leave violation interrupts unmasked. */
      mediatek,vio-irq-mask = <0>;
    };
```

## Documentation/devicetree/bindings/soc/mediatek/mediatek,mt6589-emi.yaml
```yaml
# SPDX-License-Identifier: (GPL-2.0-only OR BSD-2-Clause)
%YAML 1.2
---
$id: http://devicetree.org/schemas/soc/mediatek/mediatek,mt6589-emi.yaml#
$schema: http://devicetree.org/meta-schemas/core.yaml#

title: MediaTek MT6589 EMI (External Memory Interface)

maintainers:
  - Akari Tsuyukusa <akkun11.open@gmail.com>

description: |
  The MT6589 EMI block sits between the bus and the DRAM controller and
  provides three things this driver exposes:

  - a bus monitor that samples DRAM bandwidth and transaction counts, both
    in total and for one selected master;
  - a memory protection unit with eight regions, each with a base and end
    address in 64KB units and four 3-bit permissions, one per bus domain
    (AP, modem 0, modem 1, multimedia), plus a violation interrupt;
  - per-master bandwidth filter and page-miss controls.

  The register window is 0x1020_3000.  Downstream names the same block at
  0xF0203000 (mt_reg_base.h "EMI_BASE"), which maps back to 0x1020_3000.

  No MPU region is programmed unless the board describes one, because
  setting a region's permissions wrongly on this block stops the CPU from
  reading its own memory and there is no way back at runtime.  The
  downstream default table needs the modem image memory map, which a mainline
  board does not have.

properties:
  compatible:
    const: mediatek,mt6589-emi

  reg:
    maxItems: 1
    description: The EMI configuration window, 0x1020_3000.

  interrupts:
    maxItems: 1
    description: |
      The bus-protection violation line, GIC SPI 94.  On MT6589 this line is
      shared: the device APC raises it for its own violations and the SMI
      does for its, which is why the downstream driver requests it with
      IRQF_SHARED.  The interrupt is optional; without it the monitor and the
      MPU region API still work, and violations are still latched in the
      status registers.

  mediatek,mpu-region:
    description: |
      Optionally pre-program one or more MPU regions.  Each entry is
      <region start end ap md0 md1 mm>, where region is 0..7, start and end
      are physical addresses and are rounded down to 64KB, and the four
      permissions are values from the table in the datasheet (p. 615):
      0 = no protection, 1 = secure read/write, 2 = secure read/write plus
      non-secure read, 3 = secure read/write plus non-secure write,
      4 = read only, 5 = forbidden.

      Omit it to leave the hardware as the bootloader configured it, which
      is the safe default and the only one that is right without knowing the
      board's memory layout.
    $ref: /schemas/types.yaml#/definitions/uint32-matrix
    items:
      items:
        - description: region index, 0..7
          minimum: 0
          maximum: 7
        - description: start address, physical
        - description: end address, physical
        - description: permission for the application processor domain
          minimum: 0
          maximum: 5
        - description: permission for the modem 0 domain
          minimum: 0
          maximum: 5
        - description: permission for the modem 1 domain
          minimum: 0
          maximum: 5
        - description: permission for the multimedia domain
          minimum: 0
          maximum: 5

required:
  - compatible
  - reg

additionalProperties: false

examples:
  - |
    #include <dt-bindings/interrupt-controller/arm-gic.h>

    emi: memory-controller@10203000 {
        compatible = "mediatek,mt6589-emi";
        reg = <0x10203000 0x1000>;
        interrupts = <GIC_SPI 94 IRQ_TYPE_LEVEL_LOW>;
    };
```

## Documentation/devicetree/bindings/sound/mediatek,mt6320-accdet.yaml
```yaml
$schema: http://devicetree.org/meta-schemas/core.yaml#

title: MediaTek MT6320 headset accessory detector

maintainers:
  - Akari Tsuyukusa <akkun11.open@gmail.com>

properties:
  compatible:
    const: mediatek,mt6320-accdet

  detect-gpios:
    maxItems: 1

  io-channels:
    maxItems: 1

  io-channel-names:
    const: key

  clocks:
    maxItems: 1

  clock-names:
    const: accdet

required:
  - compatible
  - detect-gpios
  - io-channels
  - io-channel-names
  - clocks
  - clock-names

additionalProperties: false
```

## Documentation/devicetree/bindings/sound/mediatek,mt6572-mt6323.yaml
```yaml
# SPDX-License-Identifier: (GPL-2.0-only OR BSD-2-Clause)
%YAML 1.2
---
$id: http://devicetree.org/schemas/sound/mediatek,mt6572-mt6323.yaml#
$schema: http://devicetree.org/meta-schemas/core.yaml#

title: MediaTek MT6572 sound card with the MT6323 PMIC codec

maintainers:
  - Custom Firmware <gabin278@gmail.com>

description:
  The machine-level sound card binding the MT6572 AFE platform to the MT6323
  PMIC analog codec.

allOf:
  - $ref: sound-card-common.yaml#

properties:
  compatible:
    const: mediatek,mt6572-mt6323-sound

  aux-devs:
    $ref: /schemas/types.yaml#/definitions/phandle-array
    description:
      List of phandles pointing to auxiliary devices, such as an external
      speaker amplifier.

  mediatek,platform:
    $ref: /schemas/types.yaml#/definitions/phandle
    description: phandle to the MT6572 AFE platform.

  mediatek,accdet:
    $ref: /schemas/types.yaml#/definitions/phandle
    description:
      The phandle to the MT6323 accessory detection block, which detects audio
      jack insertion and removal. This property should only be present if the
      accdet block is actually wired to the audio jack pins and to be used for
      jack detection.

required:
  - compatible
  - mediatek,platform

unevaluatedProperties: false
```

## Documentation/devicetree/bindings/sound/mediatek,mt6589-audio.yaml
```yaml
# SPDX-License-Identifier: (GPL-2.0-only OR BSD-2-Clause)
%YAML 1.2
---
$id: http://devicetree.org/schemas/sound/mediatek,mt6589-audio.yaml#
$schema: http://devicetree.org/meta-schemas/core.yaml#

title: MediaTek MT6589 Audio Front End (AFE)

maintainers:
  - Akari Tsuyukusa <akkun11.open@gmail.com>

description: |
  The audio front end of the MT6589 hosts the memory interfaces (DL1
  playback, VUL capture), the interconnect that routes between them, the
  I2S input and output blocks, and the AFE<->PMIC serial link driven
  through the audsys syscon it is a child of.

  Note that there is no ADDA block on this part: no ADDA register is
  documented for the MT6589, and chapter 63's register map has nothing
  between AFE_MEMIF_MON4 (0x00e0) and AFE_FOC_CON (0x0170).  Sample-rate
  conversion for the PMIC link is done in the MT6320 codec, not here.

properties:
  compatible:
    enum:
      - mediatek,mt6589-audio

  clocks:
    minItems: 2
    maxItems: 2

  clock-names:
    items:
      - const: afe
      - const: i2s

  interrupts:
    maxItems: 1

  iram:
    $ref: /schemas/types.yaml#/definitions/phandle
    description:
      Genalloc-backed on-chip SRAM used for the AFE PCM DMA buffer.

required:
  - compatible
  - clocks
  - clock-names
  - iram
  - interrupts

additionalProperties: false

examples:
  - |
    #include <dt-bindings/clock/mediatek,mt6589-clk.h>
    #include <dt-bindings/interrupt-controller/arm-gic.h>
    #include <dt-bindings/interrupt-controller/irq.h>

    afe_sram: sram@12008000 {
        compatible = "mmio-sram";
        reg = <0x12008000 0x4000>;
    };

    audsys: clock-controller@12070000 {
        compatible = "mediatek,mt6589-audsys", "syscon", "simple-mfd";
        reg = <0x12070000 0x1000>;
        #clock-cells = <1>;

        afe: audio-controller {
            compatible = "mediatek,mt6589-audio";
            clocks = <&audsys CLK_AUDIO_AFE>,
                     <&audsys CLK_AUDIO_I2S>;
            clock-names = "afe", "i2s";
            iram = <&afe_sram>;
            interrupts = <GIC_SPI 104 IRQ_TYPE_LEVEL_LOW>;
        };
    };
```
