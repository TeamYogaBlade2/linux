## drivers/phy/mediatek/phy-mtk-mipi-dphy-mt6589/Kconfig
```kconfig
# MediaTek MIPI CSI D-PHY drivers

config PHY_MEDIATEK_MIPI_CSI_DPHY
	tristate "MediaTek MT6589 MIPI CSI-2 D-PHY"
	depends on OF && HAS_IOMEM
	depends on ARCH_MEDIATEK || COMPILE_TEST
	select GENERIC_PHY
	help
	  Say Y here if you want to use the MediaTek MT6589 MIPI CSI-2
	  D-PHY.

	  This provides the D-PHY receiver that sits below the CSI-2
	  receiver and above the image sensor.  The MT6589 has two of
	  them: a 4-lane one on DVDD18_MIPIRX (CSI0) and a 1-lane one on
	  DVDD18_MIPIIO (CSI1).

	  WARNING: this driver is a stub.  It registers the PHY so that
	  the media graph is complete, but power_on() does not program
	  the analogue block, because the MT6589 data sheet does not
	  document the MIPI RX PHY registers and no vendor reference
	  driver is available.  Video will not work until the register
	  map is filled in.  See the file header for what is needed.

	  To compile this driver as a module, choose M here: the module
	  will be called phy-mtk-mipi-dphy-mt6589.
```
