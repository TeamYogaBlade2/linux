## arch/arm/configs/lenovo-blade_defconfig
```kconfig
### SoC
## MediaTek MT8125/MT8389 basic support
CONFIG_ARM=y
CONFIG_ARCH_MEDIATEK=y
CONFIG_MACH_MT6589=y
CONFIG_SMP=y
CONFIG_VFP=y
CONFIG_NEON=y
# auto select
CONFIG_VFPv3=y
CONFIG_ARM_THUMBEE=y
CONFIG_SCHED_MC=y

CONFIG_MODULES=y

### Drivers
CONFIG_OF=y
# Automatically enabled
CONFIG_MTK_INFRACFG=y

# is needed?
#CONFIG_INTERCONNECT=y
#CONFIG_INTERCONNECT_MTK=y

## CPU
CONFIG_CPU_IDLE=y
CONFIG_ARM_CPUIDLE=y
#CONFIG_CPUFREQ_DT=y
#CONFIG_CPU_FREQ=y
#CONFIG_ARM_MEDIATEK_CPUFREQ_HW=y # not ported

## IOMMU
CONFIG_IOMMU_SUPPORT=y
# MediaTek M4U
#CONFIG_MTK_IOMMU=y

## Display

## Framebuffer
CONFIG_FB=y
CONFIG_FB_SIMPLE=y
CONFIG_FRAMEBUFFER_CONSOLE=y

## Clock
CONFIG_HAVE_CLK=y
CONFIG_COMMON_CLK=y
CONFIG_COMMON_CLK_MT6589=y
CONFIG_COMMON_CLK_MT6589_AUDSYS=y
CONFIG_COMMON_CLK_MT6589_DISPSYS=y
CONFIG_COMMON_CLK_MT6589_IMGSYS=y
CONFIG_COMMON_CLK_MT6589_MFGSYS=y
CONFIG_COMMON_CLK_MT6589_VDECSYS=y
CONFIG_COMMON_CLK_MT6589_VENCSYS=y

## Timer
CONFIG_TIMER_OF=y
CONFIG_MTK_TIMER=y

## Watchdog
CONFIG_WATCHDOG=y
CONFIG_MEDIATEK_WATCHDOG=y

## UART
CONFIG_SERIAL_8250=y
CONFIG_SERIAL_8250_MT6577=y
CONFIG_SERIAL_OF_PLATFORM=y
CONFIG_SERIAL_8250_CONSOLE=y

## I2C
CONFIG_I2C=y
CONFIG_I2C_MT65XX=y

## SPI
CONFIG_SPI=y
CONFIG_SPI_MT65XX=y

## Pinctrl
CONFIG_PINCTRL=y
CONFIG_PINCTRL_MTK=y
CONFIG_EINT_MTK=y
#CONFIG_PINCTRL_MT6589=y # not ported

## GPIO

## DMA
#CONFIG_DMADEVICES=y

## USB
CONFIG_USB_SUPPORT=y
CONFIG_USB_GADGET=y
CONFIG_USB=y
CONFIG_USB_MUSB_HDRC=y
CONFIG_USB_MUSB_MEDIATEK=y
CONFIG_NOP_USB_XCEIV=y
CONFIG_USB_SERIAL=y
#CONFIG_PHY_MTK_TPHY=y # is needed?

## MMC (eMMC/SD)
CONFIG_MMC=y
CONFIG_MMC_MTK=y

## Touchscreen
#CONFIG_INPUT_TOUCHSCREEN=y
#CONFIG_TOUCHSCREEN_S7300=y # not ported

## PMIC
#CONFIG_MTK_PMIC_WRAP=y

## Power ?
#CONFIG_POWER_RESET=y

## Reset
#CONFIG_RESET_CONTROLLER

## Battery

## Audio

## Video Accelerator

## GPU
#CONFIG_SGX=y # not ported

## Wi-Fi / Bluetooth

## Thermal

## Modem

## GPS

## Camera

## PWM
#CONFIG_PWM=y
#CONFIG_PWM_MEDIATEK
#CONFIG_PWM_MTK_DISP=y

## RTC
#CONFIG_RTC_CLASS=y
#CONFIG_RTC_DRV_MT7622=y

## Android
#CONFIG_ANDROID_BINDER_IPC=y

## Block Device
CONFIG_BLK_DEV_LOOP=y

### FS
CONFIG_UNICODE=y
CONFIG_EXT4_FS=y
CONFIG_VFAT_FS=y
# VFAT
CONFIG_NLS_CODEPAGE_437=y
# VFAT
CONFIG_NLS_ISO8859_1=y
CONFIG_TMPFS=y
# pmOS
CONFIG_DEVTMPFS_MOUNT=n
CONFIG_CONFIGFS_FS=y

### Initramfs
CONFIG_BLK_DEV_INITRD=y
CONFIG_BLK_DEV_RAM=y

### Other
CONFIG_KERNEL_GZIP=y
CONFIG_VMSPLIT_3G_OPT=y
CONFIG_THUMB2_KERNEL=y

### Hacking
CONFIG_ARM_APPENDED_DTB=y
CONFIG_ARM_ATAG_DTB_COMPAT=y
CONFIG_ARM_ATAG_DTB_COMPAT_CMDLINE_EXTEND=y

### postmarketOS (must be removed!!!!!)
CONFIG_DEVTMPFS=y
CONFIG_SYSVIPC=y
CONFIG_TMPFS_POSIX_ACL=y
CONFIG_CGROUPS=y
```

## drivers/dma/mediatek/Kconfig
```kconfig
# SPDX-License-Identifier: GPL-2.0-only

config MTK_GDMA
	tristate "MediaTek AP DMA General DMA controller support"
	depends on ARCH_MEDIATEK || COMPILE_TEST
	depends on RESET_CONTROLLER
	select DMA_ENGINE
	help
	  Enable support for the AP DMA General DMA (G_DMA) engines found on
	  MediaTek MT6589 SoCs.

	  The AP DMA block holds eighteen engines, but only G_DMA0 and G_DMA1
	  are generic; the rest are wired to HIF, IrDA, I2C and UART.  These
	  two have no descriptor ring and no scatter-gather support: a
	  transfer is programmed straight into the SRC/DST/LEN1/LEN2
	  registers and completes through a single interrupt flag.

	  If unsure, say N.

config MTK_HSDMA
	tristate "MediaTek High-Speed DMA controller support"
	depends on ARCH_MEDIATEK || COMPILE_TEST
	select DMA_ENGINE
	select DMA_VIRTUAL_CHANNELS
	help
	  Enable support for High-Speed DMA controller on MediaTek
	  SoCs.

	  This controller provides the channels which is dedicated to
	  memory-to-memory transfer to offload from CPU through ring-
	  based descriptor management.

config MTK_CQDMA
	tristate "MediaTek Command-Queue DMA controller support"
	depends on ARCH_MEDIATEK || COMPILE_TEST
	select DMA_ENGINE
	select DMA_VIRTUAL_CHANNELS
	select ASYNC_TX_ENABLE_CHANNEL_SWITCH
	help
	  Enable support for Command-Queue DMA controller on MediaTek
	  SoCs.

	  This controller provides the channels which is dedicated to
	  memory-to-memory transfer to offload from CPU.

config MTK_UART_APDMA
	tristate "MediaTek SoCs APDMA support for UART"
	depends on OF && SERIAL_8250_MT6577
	select DMA_ENGINE
	select DMA_VIRTUAL_CHANNELS
	help
	  Support for the UART DMA engine found on MediaTek MTK SoCs.
	  When SERIAL_8250_MT6577 is enabled, and if you want to use DMA,
	  you can enable the config. The DMA engine can only be used
	  with MediaTek SoCs.
```

## drivers/gpu/drm/mediatek/Kconfig
```kconfig
# SPDX-License-Identifier: GPL-2.0-only
config DRM_MEDIATEK
	tristate "DRM Support for Mediatek SoCs"
	depends on DRM
	depends on ARCH_MEDIATEK || COMPILE_TEST
	depends on COMMON_CLK
	depends on HAVE_ARM_SMCCC || COMPILE_TEST
	depends on OF
	depends on MTK_MMSYS
	select DRM_CLIENT_SELECTION
	select DRM_GEM_DMA_HELPER
	select DRM_KMS_HELPER
	select DRM_DISPLAY_HELPER
	select DRM_BRIDGE_CONNECTOR
	select DRM_MIPI_DSI
	select DRM_PANEL
	select VIDEOMODE_HELPERS
	help
	  Choose this option if you have a Mediatek SoCs.
	  The module will be called mediatek-drm
	  This driver provides kernel mode setting and
	  buffer management to userspace.

config DRM_MEDIATEK_WDMA
	tristate "MediaTek DISP_WDMA write DMA engine"
	depends on DRM_MEDIATEK
	depends on HAS_IOMEM
	depends on RESET_CONTROLLER
	help
	  DISP_WDMA is the display subsystem's write-DMA engine: it takes a
	  pixel stream from an upstream block and writes it out to memory.
	  It is the counterpart of RDMA, which reads from memory instead, and
	  the two are separate blocks.

	  WDMA is not a CRTC path component and never carries a display
	  plane.  It appears in no mtk_ddp_ext array on any SoC this tree
	  supports, so selecting this option on its own will not put anything
	  on a display pipeline; it registers the component and gives the
	  DDP_COMPONENT_WDMA0/1 entries in mtk_ddp_comp.c something to call
	  into.

	  Say Y here if you want the driver built in, M to build it as a
	  module named mtk_disp_wdma, or N to leave WDMA unregistered, which
	  is the same state the MT6589 display driver is in by default.

config DRM_MEDIATEK_DP
	tristate "DRM DPTX Support for MediaTek SoCs"
	depends on DRM_MEDIATEK
	select DRM_DISPLAY_HELPER
	select DRM_DISPLAY_DP_HELPER
	select DRM_DISPLAY_DP_AUX_BUS
	help
	  DRM/KMS Display Port driver for MediaTek SoCs.

config DRM_MEDIATEK_HDMI_COMMON
	tristate
	depends on DRM_MEDIATEK
	select DRM_DISPLAY_HDMI_HELPER
	select DRM_DISPLAY_HELPER
	select SND_SOC_HDMI_CODEC if SND_SOC
	help
	  MediaTek SoC HDMI common library

config DRM_MEDIATEK_HDMI
	tristate "DRM HDMI Support for Mediatek SoCs"
	depends on DRM_MEDIATEK
	select DRM_MEDIATEK_HDMI_COMMON
	help
	  DRM/KMS HDMI driver for Mediatek SoCs

config DRM_MEDIATEK_HDMI_V2
	tristate "DRM HDMI v2 IP support for MediaTek SoCs"
	depends on DRM_MEDIATEK
	select DRM_MEDIATEK_HDMI_COMMON
	help
	  Say yes here to enable support for the HDMIv2 IP and related
	  DDCv2 as found in the MediaTek MT8195, MT8188 SoCs and other
	  variants.
	  This driver can also be built as a module. If so, the HDMIv2
	  module will be called "mtk_hdmi_v2", and the DDCv2 module
	  will be called "mtk_hdmi_ddc_v2".

config DRM_MEDIATEK_G2D
	tristate "MediaTek G2D 2D blitter"
	depends on DRM_MEDIATEK
	depends on HAS_IOMEM
	select DRM_GEM_DMA_HELPER
	help
	  The G2D block in the display subsystem does 2D copies: bitblt
	  between surfaces, and constant-colour fill.  The hardware also
	  offers flips, alpha blending and dithering, which this driver does
	  not yet use.

	  Both G2D objects - the engine and its ioctls - are built from this
	  option.  They used to be split between CONFIG_MTK_G2D and
	  CONFIG_DRM_MEDIATEK, so the ioctl object was built whenever the
	  display driver was, even with the engine itself switched off.

	  The ioctls are not registered on any DRM device yet: the block owns
	  no &drm_device of its own, so this option currently provides the
	  engine and its kernel API only.
```

## drivers/gpu/drm/prismrv/Kconfig
```kconfig
# SPDX-License-Identifier: GPL-2.0-only
config DRM_PRISMRV
	tristate "PrismRV DRM driver for PowerVR SGX GPUs"
	depends on MMU && (OF || COMPILE_TEST)
	depends on DRM
	select DRM_GEM_SHMEM_HELPER
	select PM_DEVFREQ
	select DEVFREQ_GOV_SIMPLE_ONDEMAND
	select PM_OPP
	help
	  Say Y here to enable a DRM render node for Imagination
	  PowerVR SGX GPUs as found in several ARM SoCs (e.g. the
	  MediaTek MT6589).  The core type and RTL revision are probed
	  at runtime, errata workarounds are applied per revision and
	  the microkernel firmware is loaded from userspace.

	  Firmware blobs go under prismrv/ in the firmware tree.

	  If unsure, say N.
```

## drivers/media/platform/mediatek/Kconfig
```kconfig
# SPDX-License-Identifier: GPL-2.0-only

comment "Mediatek media platform drivers"

source "drivers/media/platform/mediatek/jpeg/Kconfig"
source "drivers/media/platform/mediatek/mdp/Kconfig"
source "drivers/media/platform/mediatek/vcodec/Kconfig"
source "drivers/media/platform/mediatek/vpu/Kconfig"
source "drivers/media/platform/mediatek/mdp3/Kconfig"

config VIDEO_MT6589_SENINF
	tristate "MediaTek MT6589 SENINF sensor interface"
	depends on ARCH_MEDIATEK || COMPILE_TEST
	depends on VIDEO_DEV && COMMON_CLK && PM
	select MEDIA_CONTROLLER
	select V4L2_FWNODE
	select VIDEO_V4L2_SUBDEV_API
	select VIDEOBUF2_DMA_CONTIG
	help
	  The camera receive path of the MediaTek MT6589: the sensor master
	  clock (MCLK), the CSI-2 receiver (SENINF, MIPI-RX) and raw frames
	  through the ISP pass 1 to memory (IMGO), as a V4L2 video device.
```

## drivers/media/platform/mediatek/mtk-cam-graph/Kconfig
```kconfig
# SPDX-License-Identifier: GPL-2.0-only

config VIDEO_MTK_CAM_GRAPH
	bool
	select MEDIA_CONTROLLER
	select VIDEO_V4L2_SUBDEV_API
	select V4L2_ASYNC
	help
	  The media graph that ties the MediaTek MT6589 camera blocks together.

	  This driver owns no hardware.  It registers the struct media_device
	  and struct v4l2_device for the camera path, runs the
	  v4l2_async_notifier that pulls mtk-csi2-rx, mtk-scam and mtk-cam into
	  that v4l2_device, and creates the media links between them from the
	  "remote-endpoint" properties in the device tree.

	  Without it the three subdevs register as async subdevs that nothing is
	  waiting for, so no entity joins a media_device and no media_link is
	  ever created: the pads exist and the dtsi points them at each other,
	  but that is not a graph.

	  It is deliberately a silent bool selected by the three camera drivers
	  rather than a user-visible option: none of them can produce a graph
	  without it, so there is no configuration in which turning it off is
	  useful.  It also carries no depends of its own, because its three
	  selectors already depend on the SoC and adding a second, narrower
	  condition here would make Kconfig warn about selecting it with
	  unmet dependencies.
```

## drivers/media/platform/mediatek/mtk-cam/Kconfig
```kconfig
config VIDEO_MTK_CAM
	tristate "MediaTek MT6589 CAM/ISP control plane and IMGO DMA"
	depends on HAS_IOMEM && OF
	depends on ARCH_MEDIATEK || COMPILE_TEST
	select VIDEO_V4L2_SUBDEV_API
	select V4L2_ASYNC
	# No camera subdev can join a media graph without it: it owns the
	# media_device, the v4l2_device, the async notifier and the link
	# creation for the whole camera path.
	select VIDEO_MTK_CAM_GRAPH
	select MEDIA_CONTROLLER
	help
	  Say Y here if you want to use the MediaTek MT6589 CAM/ISP
	  control plane and IMGO output DMA.

	  This driver maps the CAM control registers at 0x15004000,
	  implements the documented software-reset handshake, block enable
	  and start/stop strobes, and programs the IMGO output DMA engine
	  from a videobuf2 capture queue.  It registers the CAM/ISP as a
	  subdev with both a sink and a source pad, and exposes the IMGO
	  output as a V4L2 capture video node with one format
	  (V4L2_PIX_FMT_UYVY, the YUV422 1-plane layout the CAM output
	  format field selects).

	  The image pipeline itself - the CPIPE stages, the memory sequencer
	  and the interrupt controllers - is NOT written, and no CPIPE stage
	  enable is programmed, because turning a stage on without writing
	  the pipeline would run it against unconfigured registers.  So the
	  video node registers cleanly, negotiates, allocates buffers and
	  starts, but the DMA engine is programmed rather than fed: there is
	  no CPIPE output for it to transfer.

	  On a board with no camera sensor - which is the case for the
	  Lenovo YOGA Tablet 8/10 this was written for, which has no sensor
	  node and no MIPI CSI-2 D-PHY in the device tree - STREAMON
	  succeeds and no frame ever completes, so DQBUF blocks until the
	  file is closed.  That is the intended inert behaviour, not a
	  defect.  See the file header.

	  To compile this driver as a module, choose M here: the module will
	  be called mtk-cam.
```

## drivers/media/platform/mediatek/mtk-csi2-rx/Kconfig
```kconfig
# MediaTek specific camera receiver support

config VIDEO_MTK_CSI2_RX
	tristate "MediaTek MT6589 CSI-2 receiver"
	depends on COMMON_CLK && HAS_IOMEM && OF
	select VIDEO_V4L2_SUBDEV_API
	select RESET_CONTROLLER
	select GENERIC_PHY
	select V4L2_ASYNC
	help
	  Say Y here if you want to use the MediaTek MT6589 camera CSI-2
	  receiver.

	  The MT6589 image subsystem contains two independent MIPI CSI-2
	  receivers (called seninf/csi2 in the vendor sources) behind one
	  register window at 0x15008000, one per camera port.  Each receiver
	  unpacks the MIPI packets and forwards the raw byte stream plus
	  frame/line synchronisation to the sensor-CAM (SCAM) block that
	  feeds the ISP.

	  This driver only programs the receivers themselves and the
	  top-level parallel sensor clock gating.  The D-PHY below them is
	  a separate driver, and the SCAM block is not yet implemented.

	  To compile this driver as a module, choose M here: the module
	  will be called mtk-csi2-rx.
```

## drivers/media/platform/mediatek/mtk-scam/Kconfig
```kconfig
config VIDEO_MTK_SCAM
	tristate "MediaTek MT6589 sensor-CAM adaptor"
	depends on HAS_IOMEM && OF
	depends on ARCH_MEDIATEK || COMPILE_TEST
	select VIDEO_V4L2_SUBDEV_API
	select V4L2_ASYNC
	select VIDEO_MTK_CAM_GRAPH
	help
	  Say Y here if you want to use the MediaTek MT6589 sensor-CAM
	  (SCAM) adaptor.

	  The SCAM blocks sit between each CSI-2 receiver and the CAM/ISP.
	  They carry the unpacked byte stream and the frame/line
	  synchronisation across to the ISP and raise the frame and line
	  interrupts the ISP uses.

	  WARNING: this driver is partial.  The reset/enable/size path is
	  implemented and it will probe, but the pixel-format handling and
	  the media-controller glue towards the ISP are not written, and
	  there is no vendor reference driver for this block in the
	  available tree.  It will not yet produce frames.  See the file
	  header and README.md.

	  To compile this driver as a module, choose M here: the module
	  will be called mtk-scam.
```

## drivers/net/wireless/mediatek/mt6628/Kconfig
```kconfig
config MT6628_WMT
	tristate "MediaTek MT6628 WMT/STP core"
	depends on SERIAL_DEV_BUS && GPIOLIB && MMC
	select FW_LOADER
	help
	  Power, UART STP, firmware patch and SDIO-rescan support for the
	  MediaTek MT6628 connectivity combo used by the Lenovo B8000-H.

config MT6628_WLAN
	tristate "MediaTek MT6628 WLAN"
	depends on MT6628_WMT && MMC && CFG80211
	select FW_LOADER
	help
	  Legacy gen2 WLAN driver for the MT6628 SDIO function.  The matching
	  WMT core and WIFI_RAM_CODE_MT6628 firmware are required.

	  This driver should be built as a module because firmware is supplied
	  by the root filesystem.
```
