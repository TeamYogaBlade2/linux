## Documentation/devicetree/bindings/arm/mediatek/mediatek,mmsys.yaml
```yaml
# SPDX-License-Identifier: (GPL-2.0 OR BSD-2-Clause)
%YAML 1.2
---
$id: http://devicetree.org/schemas/arm/mediatek/mediatek,mmsys.yaml#
$schema: http://devicetree.org/meta-schemas/core.yaml#

title: MediaTek mmsys controller

maintainers:
  - Matthias Brugger <matthias.bgg@gmail.com>

description:
  The MediaTek mmsys system controller provides clock control, routing control,
  and miscellaneous control in mmsys partition.

  The display hardware is a crossbar: components such as OVL, BLS, RDMA and
  DSI each have several possible inputs and outputs, and a set of registers
  selects which of them are connected.  mediatek,display-path names the
  components of one display pipeline in order, and mediatek,display-routes
  gives the register settings that wire its consecutive pairs together.  The
  two are read by one driver because they are one decision.

properties:
  $nodename:
    pattern: "^syscon@[0-9a-f]+$"

  compatible:
    oneOf:
      - items:
          - enum:
              - mediatek,mt2701-mmsys
              - mediatek,mt2712-mmsys
              - mediatek,mt6589-dispsys
              - mediatek,mt6765-mmsys
              - mediatek,mt6779-mmsys
              - mediatek,mt6795-mmsys
              - mediatek,mt6797-mmsys
              - mediatek,mt8167-mmsys
              - mediatek,mt8173-mmsys
              - mediatek,mt8183-mmsys
              - mediatek,mt8186-mmsys
              - mediatek,mt8188-vdosys0
              - mediatek,mt8188-vdosys1
              - mediatek,mt8188-vppsys0
              - mediatek,mt8188-vppsys1
              - mediatek,mt8192-mmsys
              - mediatek,mt8195-vdosys1
              - mediatek,mt8195-vppsys0
              - mediatek,mt8195-vppsys1
              - mediatek,mt8365-mmsys
          - const: syscon

      - description: vdosys0 and vdosys1 are 2 display HW pipelines,
                     so mt8195 binding should be deprecated.
        deprecated: true
        items:
          - const: mediatek,mt8195-mmsys
          - const: syscon

      - items:
          - const: mediatek,mt7623-mmsys
          - const: mediatek,mt2701-mmsys
          - const: syscon

      - items:
          - const: mediatek,mt8195-vdosys0
          - const: mediatek,mt8195-mmsys
          - const: syscon

  reg:
    maxItems: 1

  power-domains:
    description:
      A phandle and PM domain specifier as defined by bindings
      of the power controller specified by phandle. See
      Documentation/devicetree/bindings/power/power-domain.yaml for details.

  mboxes:
    description:
      Using mailbox to communicate with GCE, it should have this
      property and list of phandle, mailbox specifiers. See
      Documentation/devicetree/bindings/mailbox/mediatek,gce-mailbox.yaml
      for details.
    $ref: /schemas/types.yaml#/definitions/phandle-array

  mediatek,gce-client-reg:
    description:
      The register of client driver can be configured by gce with 4 arguments
      defined in this property, such as phandle of gce, subsys id,
      register offset and size.
      Each subsys id is mapping to a base address of display function blocks
      register which is defined in the gce header
      include/dt-bindings/gce/<chip>-gce.h.
    $ref: /schemas/types.yaml#/definitions/phandle-array
    maxItems: 1

  "#clock-cells":
    const: 1

  '#reset-cells':
    const: 1

  mediatek,display-path:
    description:
      A display pipeline, as a list of component names in the order the
      pipeline runs.  Every component named here must exist and be enabled,
      or no CRTC is created for the pipeline.

      This property programs no register by itself; it describes the pipeline
      that mediatek,display-routes then wires up.

    $ref: /schemas/types.yaml#/definitions/string-list

  mediatek,display-routes:
    description:
      The crossbar settings for the display pipeline, as a list of
      "<from> <to> <offset> <mask> <value>" strings, where from and to are
      component names as used in mediatek,display-path and offset is a byte
      offset into the mmsys register block.

      A connection may need more than one entry, for example when it needs both
      an output-port enable and an input selector.  All entries matching a pair
      are applied.

      An offset of 0 means the pair is a fixed link, wired together in hardware
      with no register to program.  It is written this way rather than left out
      so that fixed links are stated instead of merely absent.

      A pair that mediatek,display-path connects but that is missing here
      fails: the CRTC is not enabled and the missing pair is reported, rather
      than the display silently showing nothing.  Entries naming blocks with no
      driver are allowed and simply unused.

    $ref: /schemas/types.yaml#/definitions/string-list

  port:
    $ref: /schemas/graph.yaml#/properties/port
    description:
      Output port node. This port connects the MMSYS/VDOSYS output to
      the first component of one display pipeline, for example one of
      the available OVL or RDMA blocks.
      Some MediaTek SoCs support multiple display outputs per MMSYS.
    properties:
      endpoint@0:
        $ref: /schemas/graph.yaml#/properties/endpoint
        description: Output to the primary display pipeline

      endpoint@1:
        $ref: /schemas/graph.yaml#/properties/endpoint
        description: Output to the secondary display pipeline

      endpoint@2:
        $ref: /schemas/graph.yaml#/properties/endpoint
        description: Output to the tertiary display pipeline

    anyOf:
      - required:
          - endpoint@0
      - required:
          - endpoint@1
      - required:
          - endpoint@2

required:
  - compatible
  - reg
  - "#clock-cells"

additionalProperties: false

examples:
  - |
    #include <dt-bindings/power/mt8173-power.h>
    #include <dt-bindings/gce/mt8173-gce.h>

    mmsys: syscon@14000000 {
        compatible = "mediatek,mt8173-mmsys", "syscon";
        reg = <0x14000000 0x1000>;
        power-domains = <&spm MT8173_POWER_DOMAIN_MM>;
        #clock-cells = <1>;
        #reset-cells = <1>;
        mboxes = <&gce 0 CMDQ_THR_PRIO_HIGHEST>,
                 <&gce 1 CMDQ_THR_PRIO_HIGHEST>;
        mediatek,gce-client-reg = <&gce SUBSYS_1400XXXX 0 0x1000>;
    };
```

## Documentation/devicetree/bindings/clock/mediatek,mt6589-mempll.yaml
```yaml
# SPDX-License-Identifier: (GPL-2.0-only OR BSD-2-Clause)
%YAML 1.2
---
$id: http://devicetree.org/schemas/clock/mediatek,mt6589-mempll.yaml#
$schema: http://devicetree.org/meta-schemas/core.yaml#

title: MediaTek MT6589 MEMPLL (DRAM PLL)

maintainers:
  - Akari Tsuyukusa <akkun11.open@gmail.com>

description: |
  The MT6589 MEMPLL is the PLL that clocks the DRAM controller.  Its
  registers are not in the apmixedsys window: MEMPLL0..MEMPLL12 and
  MEMPLL_DIVIDER live in the ddrphy_conf module at 0x1001_1600..0x1001_1640,
  and the power-on debounce registers MPLLPON0..3 at 0x1001_15C0, per the
  MT6589 datasheet section 13.4.3 ("DDRPHY Registers").  The node therefore
  lives in the ddrphy_conf window rather than under apmixedsys.

  The binding exposes the MEMPLL as a single read-only clock output.  The
  rate is declared by the board with "clock-frequency" rather than decoded
  from the registers, because the register set does not determine it
  unambiguously: MEMPLL0's feedback divider field is not the divider for
  PLL1, the reference can be either the crystal or the APLL plus a divider
  (MEMPLL1[12:11]), and the downstream frequency tables map several
  different DRAM rates onto the same DDS value.

  The MEMPLL selection for the DRAM clock is still made in topckgen, not
  here; the clock output of this node is what topckgen's "clkph_mck" is
  parented to.

properties:
  compatible:
    const: mediatek,mt6589-mempll

  reg:
    maxItems: 1
    description: |
      The ddrphy_conf window, at minimum covering the MEMPLL registers,
      i.e. 0x600 through 0x640 of that block.

  clock-frequency:
    description: |
      Frequency of the MEMPLL output in Hz, as configured by the bootloader
      for the DRAM rate this board runs at.  Defaults to 266500000, the
      figure the datasheet states for this clock ("MEMPLL_MCK 266.5MHz").
    minimum: 1

  "#clock-cells":
    const: 0

required:
  - compatible
  - reg
  - "#clock-cells"

allOf:
  - $ref: /schemas/clock/clock.yaml#

additionalProperties: false

examples:
  - |
    #include <dt-bindings/clock/mediatek,mt6589-clk.h>

    ddrphy: syscon@10011000 {
        compatible = "mediatek,mt6589-mempll";
        reg = <0x10011000 0x1000>;
        #clock-cells = <0>;
    };
```

## Documentation/devicetree/bindings/display/mediatek/mediatek,tdshp.yaml
```yaml
# SPDX-License-Identifier: (GPL-2.0-only OR BSD-2-Clause)
%YAML 1.2
---
$id: http://devicetree.org/schemas/display/mediatek/mediatek,tdshp.yaml#
$schema: http://devicetree.org/meta-schemas/core.yaml#

title: MediaTek Two-Dimension Sharpness Processor (TDSHP)

maintainers:
  - AngeloGioacchino Del Regno <angelogioacchino.delregno@collabora.com>
  - Matthias Brugger <matthias.bgg@gmail.com>

description: |
  The MediaTek TDSHP is a two-dimension sharpness processor found in
  various MediaTek SoCs. On MT6589 the block sits between the COLOR
  processor and BLS in the display pipeline and is used in relay mode.

properties:
  compatible:
    const: mediatek,mt6589-disp-tdshp

  reg:
    maxItems: 1

  interrupts:
    maxItems: 1

  clocks:
    maxItems: 1

required:
  - compatible
  - reg
  - clocks

additionalProperties: false

examples:
  - |
    #include <dt-bindings/clock/mediatek,mt6589-clk.h>
    #include <dt-bindings/interrupt-controller/arm-gic.h>
    #include <dt-bindings/interrupt-controller/irq.h>

    soc {
        #address-cells = <1>;
        #size-cells = <1>;
        ranges;

        tdshp@1400b000 {
            compatible = "mediatek,mt6589-disp-tdshp";
            reg = <0x1400b000 0x1000>;
            interrupts = <GIC_SPI 170 IRQ_TYPE_LEVEL_LOW>;
            clocks = <&dispsys CLK_DISP0_2DSHP>;
        };
    };
```

## Documentation/devicetree/bindings/display/panel/lenovo,b6000-panels.yaml
```yaml
# SPDX-License-Identifier: (GPL-2.0-only OR BSD-2-Clause)
%YAML 1.2
---
$id: http://devicetree.org/schemas/display/panel/lenovo,b6000-panels.yaml#
$schema: http://devicetree.org/meta-schemas/core.yaml#

title: Lenovo YOGA Tablet 8 (B6000) DSI panels

maintainers:
  - Akari Tsuyukusa <akkun11.open@gmail.com>

description: |
  The Lenovo YOGA Tablet 8 (B6000) is fitted with one of two 800x1280
  panels, distinguished by the compatible string:

    nt35521_cmi_080     Novatek NT35521
    s6d7aa0x04_cpt_080  Samsung S6D7AA0

  Neither can be described as a "simple panel": both need a manufacturer
  command init sequence before they will display anything.

allOf:
  - $ref: panel-common.yaml#

properties:
  compatible:
    enum:
      - lenovo,b6000-nt35521-cmi
      - lenovo,b6000-s6d7aa0x04-cpt

  reg:
    maxItems: 1

  vdd-supply:
    description: Main panel supply.
  vddi-supply:
    description: I/O supply.

  backlight: true
  port: true
  reset-gpios: true

  enable-gpios:
    description: |
      Optional enable line driven high before the reset sequence.  The
      vendor's lcd_power_en() helper was not recovered, so this is modelled
      from the board wiring rather than copied from it.

required:
  - compatible
  - reg
  - port

additionalProperties: false

examples:
  - |
    #include <dt-bindings/gpio/gpio.h>

    dsi {
        #address-cells = <1>;
        #size-cells = <0>;

        panel@0 {
            compatible = "lenovo,b6000-nt35521-cmi";
            reg = <0>;

            vdd-supply = <&panel_vdd>;
            vddi-supply = <&panel_vddi>;
            reset-gpios = <&pio 137 GPIO_ACTIVE_LOW>;

            port {
                panel_in: endpoint {
                    remote-endpoint = <&dsi_out>;
                };
            };
        };
    };
...
```
