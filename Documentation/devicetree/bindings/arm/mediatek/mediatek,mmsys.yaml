## Documentation/devicetree/bindings/media/mediatek,mt6589-mipi-csi-dphy.yaml
```yaml
# SPDX-License-Identifier: (GPL-2.0-only OR BSD-2-Clause)
%YAML 1.2
---
$id: http://devicetree.org/schemas/phy/mediatek,mt6589-mipi-csi-dphy.yaml#
$schema: http://devicetree.org/schemas/base.yaml#

title: Mediatek MT6589 MIPI CSI-2 D-PHY

maintainers:
  - Lenovo Linux Team

description:
  The MT6589 sensor front end contains two MIPI CSI-2 D-PHY receivers
  below the SENINF CSI-2 receivers:

    CSI0  DVDD18_MIPIRX  a 4-lane D-PHY (RD0..RD3 plus RCK)
    CSI1  DVDD18_MIPIIO  a 1-lane interface

  This binding follows the DT contract of the in-tree MT8365 SENINF PHY
  (mediatek,mt8365-csi-rx) so that a single consumer works with either:
  the number of lanes is given by num-lanes, and the operating mode is
  either carried in the PHY cells (#phy-cells = <1>) or by the phy-type
  property (#phy-cells = <0>).  The MT6589 has no C-PHY, so only
  PHY_TYPE_DPHY is valid.

  mediatek,mipi-csi-port is MT6589-specific and selects which of the two
  PHYs the node describes.

  WARNING: the driver behind this binding is a stub.  The register map of
  the MT6589 MIPI RX PHY is not documented in the MT6589 data sheet, so
  power_on() does not program the analogue block and no video will be
  produced.  The node exists so the graph is complete and the failure is
  visible as dead video rather than as writes to unknown registers.

properties:
  compatible:
    const: mediatek,mt6589-mipi-csi-dphy

  reg:
    description:
      Register window of the D-PHY.

      Placeholder.  The address in the example below is the sensor front
      end window that contains the seninf/csi2/SCAM registers, which is
      known to be a valid aperture, but it is NOT known to be where the
      PHY registers live.  Must be corrected before this node is relied
      on.
    maxItems: 1

  mediatek,mipi-csi-port:
    description:
      Which D-PHY this is.  Optional.

      0 selects the 4-lane CSI0 on DVDD18_MIPIRX, which carries the main
      (rear) camera.  1 selects the 1-lane CSI1 on DVDD18_MIPIIO, which
      carries the front camera.

      This property is not part of the shared mediatek,mt8365-csi-rx
      binding, so it is optional here: a node written against that binding
      still works and the driver programs the primary receiver (CSI0).
    enum: [0, 1]
    default: 0

  num-lanes:
    description:
      Number of MIPI data lanes the sensor uses.  CSI0 supports 1 to 4;
      CSI1 is fixed at 1.
    enum: [1, 2, 3, 4]
    default: 2

  phy-type:
    description:
      If the PHY doesn't support mode selection then this sets the
      operating mode.  See include/dt-bindings/phy/phy.h for constants.
      The MT6589 has no C-PHY, so only PHY_TYPE_DPHY (10) is valid.
    const: 10
    $ref: /schemas/types.yaml#/definitions/uint32

  '#phy-cells':
    description:
      If the PHY doesn't support mode selection then #phy-cells must be 0
      and the PHY mode is described using the phy-type property.
      If the PHY supports mode selection, then #phy-cells must be 1 and
      the mode is set in the PHY cells.  The only supported mode is
      PHY_TYPE_DPHY; see include/dt-bindings/phy/phy.h for constants.

      The MT6589 has no C-PHY, so #phy-cells = <0> with phy-type = <10> is
      the expected configuration.
    enum: [0, 1]

  power-domains:
    maxItems: 1

  resets:
    maxItems: 1

  reset-names:
    const: seninf

  # The D-PHY has a sink facing the sensor and a source facing the
  # CSI-2 receiver.
  ports:
    $ref: /schemas/graph/ports.yaml#

required:
  - compatible
  - reg
  - num-lanes
  - '#phy-cells'
  - ports

additionalProperties: false

examples:
  - |
    #include <dt-bindings/phy/phy.h>
    {
        mipi_csi_phy0: mipi-csi-phy {
            compatible = "mediatek,mt6589-mipi-csi-dphy";
            reg = <0x0 0x15008000 0x0 0x900>;

            mediatek,mipi-csi-port = <0>;
            num-lanes = <2>;

            phy-type = <PHY_TYPE_DPHY>;
            #phy-cells = <0>;

            ports {
                csi2_phy0_in: port@0 {
                    csi2_phy0_in_ep: endpoint {
                        remote-endpoint = <&a5142_out_ep>;
                    };
                };

                csi2_phy0_out: port@1 {
                    csi2_phy0_out_ep: endpoint {
                        remote-endpoint = <&seninf_in_ep>;
                    };
                };
            };
        };
    };

...
```

## Documentation/devicetree/bindings/media/mediatek,mt6589-scam.yaml
```yaml
# SPDX-License-Identifier: (GPL-2.0-only OR BSD-2-Clause)
%YAML 1.2
---
$id: http://devicetree.org/schemas/media/mediatek,mt6589-scam.yaml#
$schema: http://devicetree.org/schemas/base.yaml#

title: MediaTek MT6589 sensor-CAM (SCAM) adaptor

maintainers:
  - Lenovo Linux Team

description: >
  The SCAM blocks sit between each CSI-2 receiver and the CAM/ISP on the
  MT6589.  They take the unpacked byte stream plus the frame and line
  synchronisation the receiver produces, convert it to the ISP's line-based
  handshake, and raise the interrupts the ISP uses.

  The blocks are at 0x15008200 with a 0x80 stride between the two instances.

  WARNING: the driver behind this binding is partial.  The reset, enable
  and size path is implemented and it will probe, but the pixel-format
  handling and the media-controller glue towards the ISP are not written.
  It will not yet produce frames.

properties:
  compatible:
    const: mediatek,mt6589-scam

  reg:
    description: |
      Register window of THIS PORT'S SCAM BLOCK ONLY.  Port 0 is SCAM1_CFG at
      0x15008200 through SCAM1_STA at 0x15008240 plus its 32 bits, i.e.
      0x44 bytes; port 1 is the same layout 0x80 further up at 0x15008280.

      The window must NOT be widened.  It used to be documented as
      <0x0 0x15008000 0x0 0x900>, which is byte-for-byte the window the
      CSI-2 receiver claims: two platform devices cannot share one aperture,
      and the SCAM driver computes its offsets from the start of its own
      block, so pointing it at 0x15008000 made every SCAM1_CFG access land on
      the receiver's SENINF_TOP_CTRL.
    maxItems: 1

  mediatek,scam-port:
    description: |
      Which SCAM instance this node programs.  Port 0 is SCAM1 at
      0x15008200, port 1 is SCAM2 at 0x15008280.  On the Lenovo YOGA
      Tablet 8/10 port 0 is the main (rear) camera.

      One node per port: the "reg" above is per-port, so a second receiver
      needs a second node with mediatek,scam-port = <1> and reg =
      <0x0 0x15008280 0x0 0x44>, not a wider window on the first node.
    enum: [0, 1]
    default: 0

  power-domains:
    maxItems: 1

  resets:
    maxItems: 1

  # A sink pad fed by the CSI-2 receiver (the mediatek,mt6589-csi2-rx
  # binding's seninf_out endpoint) and a source pad feeding the CAM/ISP.
  ports:
    $ref: /schemas/graph/ports.yaml#

required:
  - compatible
  - reg
  - mediatek,scam-port
  - ports

additionalProperties: false

examples:
  - |
    scam: scam@15008200 {
        compatible = "mediatek,mt6589-scam";
        reg = <0x0 0x15008200 0x0 0x44>;

        mediatek,scam-port = <0>;

        /*
         * scam_in_ep is the receiver's source endpoint (seninf_out_ep in
         * the mediatek,mt6589-csi2-rx binding) and cam_in_ep is the CAM/ISP
         * node's sink endpoint (mediatek,mt6589-cam); both are defined in
         * their own bindings.
         *
         * Port 1 would be a second, separate node at 0x15008280/0x44 with
         * mediatek,scam-port = <1> - not a wider window on this one.
         */
        ports {
            scam_in: port@0 {
                scam_in_ep: endpoint {
                    remote-endpoint = <&seninf_out_ep>;
                };
            };

            scam_out: port@1 {
                scam_out_ep: endpoint {
                    remote-endpoint = <&cam_in_ep>;
                };
            };
        };
    };

...
```

## Documentation/devicetree/bindings/media/mediatek,mt6589-vcodec.yaml
```yaml
# SPDX-License-Identifier: (GPL-2.0-only OR MIT)
%YAML 1.2
---
$id: http://devicetree.org/schemas/mediatek,mt6589-vcodec.yaml#
$schema: http://devicetree.org/schemas/bindings.yaml#

title: MediaTek MT6589 Video Codec (VENC and VDEC)

description: |
  The MT6589 video codec is a hardwired RTL accelerator with two register
  blocks: an H.264/VP8 video encoder (VENC) and a multi-standard video decoder
  (VDEC).  Unlike the later MediaTek VPU/IPI generations there is no
  coprocessor and no firmware: both blocks are programmed through MMIO, and
  power is a plain clock gate in the VEN and VDE power domains.

  This binding describes a single node covering both blocks, mirroring the
  vendor topology where one device serves both the encoder and the decoder.

  DRAFT DRIVER - SCOPE OF WHAT ACTUALLY WORKS
  ------------------------------------------
  This driver is a resource layer plus a partial H.264 encode front end.  Read
  this before assuming a conformant codec is present.

  What it does do:

  - Probes the two register windows, the three clocks and the two IRQ lines.
  - Brings both engines out of reset and gates their clocks through runtime
    PM, and serialises the per-engine operations with a mutex.
  - Programs the chapter-60 H.264 datapath: the bitstream, source, reference
    and reconstruction address registers, and the quantiser triple, target bit
    rate, CBR/initial-QP mode bits, frame rate and P/B QP adjust limiters,
    rejecting quantisers outside the documented 0..51 range.
  - Allocates and owns the bitstream, reference, reconstruction and rate
    control scratch buffers those address registers need.
  - Acknowledges the encoder frame-done interrupt, handles a bitstream-buffer
    overflow, and reports the coded bitstream length; a watchdog
    (MTK_VENC_TIMEOUT_MS) retires a frame the hardware never completes, so a
    wedged engine cannot pin a clock reference forever.
  - Exposes the H.264 datapath as one V4L2 memory-to-memory codec node (NV12
    in, bitstream out).
  - Registers a second V4L2 memory-to-memory node for the decoder (bitstream
    in, NV12 out).  The node is real and supports capability query and format
    negotiation, but its device_run() reports -ENODEV: see "Decode" below.
    It exists so that a decoder client can discover the block and be told
    plainly that it cannot use it, rather than finding no node at all.

  What it does NOT do:

  - Decode.  The VDEC window is mapped, its clock is gated and its frame-end
    interrupt is acknowledged, but the decoder datapath is not programmed at
    all.  This is architectural, not an omission: the vendor stack programs
    the decoder from userspace, not from the kernel.  Its kernel driver
    touches the block only to power it up and acknowledge the frame-end
    interrupt, while the register sequence itself is shipped to it as a queue
    of WRITE_REG_CMD records that closed userspace libraries assemble and pass
    over the MFV_SET_CMD_CMD ioctl, and the driver merely walks that queue.
    The decode sequence therefore lives in stripped, partly encrypted ARM
    blobs.  Two further obstacles are documented in the driver's register
    header: the only readable register map is the vendor LDVT register-test
    harness, which is configured for MT8580 rather than MT6589, and VP8
    additionally requires its probability tables pushed bit-by-bit into parser
    SRAM before any frame can decode.  Userspace of this driver must not expect
    a decoded picture.
  - Conformant bitstreams.  Entropy coding, motion estimation and the
    coefficient buffer exist only in the vendor's closed userspace libraries
    and were not ported, and the bitrate algorithm behind the RC registers is
    the vendor's.  The registers are programmed; the codec is not implemented.
    Userspace must treat the output as opaque.
  - Slice control (a frame larger than one MB row is never split into slices),
    and SPS/PPS emission (no parameter-set buffer is allocated).
  - MPEG-4 encoding: its address programming and interrupt exist, but the three
    chroma planes and the per-MB side-information buffer at VENC_MP4_SIDE_ADDR
    are not allocated, so a submit is rejected with -ENODEV.
  - VP8 beyond what mtk_venc_bitstream_size() restricts it to.

  There is no hardware to test against, so none of this is claimed to work end
  to end.

  Note on power-domains: the property is accepted and described below, but the
  driver as it stands does not itself call dev_pm_domain_get() or run the SCM
  power-on sequence.  A node providing them is not wrong - the clocks are taken
  through them by the clock driver - but do not read the driver's presence as
  evidence that it drives the domains itself.

maintainers:
  - Akari Tsuyukusa <akkun11.open@gmail.com>

properties:
  compatible:
    oneOf:
      - items:
          - const: mediatek,mt6589-vcodec

  reg:
    minItems: 2
    maxItems: 2
    description: |
      Two register windows, in order: the encoder followed by the decoder.

      The encoder is 4 KiB at 0x17002000 and is documented twice over: data
      sheet chapter 60 (H.264 and VP8) and chapter 61 (MPEG-4), the latter
      starting at offset 0x600 inside the same window.

      The decoder is 0x29000 bytes at 0x16020000, itself split into a MISC
      block at offset 0 and a VLD (bitstream parser) block at offset 0x1000.
      Note this is 0x16020000 and NOT 0x16000000, which is the vdecsys clock
      controller.  It comes from the stock mt_reg_base.h VDEC_BASE 0xF6020000
      after the +0xE0000000 remap.  The data sheet contains no register
      definition for the decoder at all, so a binding cannot describe its
      register layout.

  interrupts:
    minItems: 2
    maxItems: 2
    description: |
      Two interrupt lines, in order: the encoder followed by the decoder.
      The two are wired with opposite polarity: the encoder interrupt is
      asserted low and the decoder interrupt is asserted high, so the DT must
      use IRQ_TYPE_LEVEL_LOW for the first and IRQ_TYPE_LEVEL_HIGH for the
      second.  Using one polarity for both will silently never fire.

  clocks:
    minItems: 3
    maxItems: 3
    description: |
      Three clock gates, in order: the encoder engine, the decoder engine and
      the decoder SMI (LARB) clock.  clock-names is required because the
      encoder clock comes from the vencsys provider and the two decoder
      clocks from vdecsys, and each provider numbers its own gates from zero,
      so the provider-local clock ids overlap and are not a unique key.

  clock-names:
    items:
      - const: venc
      - const: vdec-vde
      - const: vdec-smi

  power-domains:
    minItems: 2
    maxItems: 2
    description: |
      The encoder and decoder power domains, VEN and VDE, in that order.
      Both are powered off at reset and require the SCM power-on sequence.

  iommus:
    minItems: 1
    items:
      description: M4U port for a codec DMA engine.

required:
  - compatible
  - reg
  - interrupts
  - clocks
  - clock-names
  - power-domains

additionalProperties: false
```
