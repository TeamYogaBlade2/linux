## Documentation/devicetree/bindings/leds/mediatek,mt6320-led.yaml
```yaml
# SPDX-License-Identifier: (GPL-2.0-only OR BSD-2-Clause)
%YAML 1.2
---
$id: http://devicetree.org/schemas/leds/mediatek,mt6320-led.yaml#
$schema: http://devicetree.org/schemas/base.yaml#

title: MediaTek MT6320 PMIC LEDs

maintainers:
  - Lenovo Linux Team

description: >
  The MT6320 companion PMIC, used with MediaTek MT6589 SoCs, provides three
  constant-current LED sinks (ISINK, called NLED in the vendor sources) plus
  a fourth sink dedicated to the keypad backlight.  These LEDs are wired into
  the PMIC rather than to SoC GPIOs, so each one needs its own current step,
  dimming counter and enable bit programmed inside the PMIC.

  Each LED is a child node of the PMIC node.  There are two distinct kinds
  of child, and they are described separately below because their required
  properties differ: an ISINK channel, identified by its "reg" index, and
  the single keypad backlight sink, identified by "mediatek,is-kpled".

properties:
  compatible:
    oneOf:
      - const: mediatek,mt6320-led
      - items:
          - const: mediatek,mt6320
          - const: mediatek,mt6320-led
    description: >
      Conformance to the PMIC type is optional for compatibility with
      existing vendor bindings, which often only set the first string.

# Child nodes carry no unit address, so they are matched by name: boards name
# them freely ("keypad-backlight", "red", "isink-ch0", ...), so a catch-all
# pattern is needed rather than the "led@[0-9a-f]" form used by I2C LED
# controllers.
patternProperties:
  "^[a-zA-Z0-9][a-zA-Z0-9,_-]*$":
    type: object
    $ref: common.yaml#
    unevaluatedProperties: false

    properties:
      reg:
        description: >
          Index of the LED current sink within the PMIC.  This is a channel
          number, not an MMIO address: the sinks live in the ISINKS_CONx
          registers and are addressed by an index 0, 1 or 2.
        enum: [0, 1, 2]

      mediatek,is-kpled:
        type: boolean
        description: >
          Marks this node as the dedicated keypad backlight sink on KPLED_CON0
          rather than one of the three ISINK channels.  That sink has no
          channel index and no current step, so a node carrying this property
          must not have "reg" or "mediatek,num-steps".

      mediatek,num-steps:
        minimum: 1
        maximum: 8
        default: 4
        description: >
          Number of current step codes this sink exposes.  This is the sink's
          max_brightness and it is the only control on the current level: a
          brightness of N selects current step N-1, so with the default of 4 a
          brightness of 4 lights the sink at the highest step code available.
          A brightness of 0 switches the sink off.

          The MT6320 step field is three bits wide, so 1..8 codes is
          representable, but the vendor driver only uses codes 0..3.  A board
          that wired its LED for a fixed current, as the vendor driver does,
          can expose a single code with num-steps = 1 and then always run it
          at brightness 1.

      delay-on:
        $ref: /schemas/types.yaml#/definitions/uint32
        description: >
          Default blink on-time in milliseconds.  Must be set together with
          delay-off, and both must be non-zero.  Optional; without it the LED
          has no default timing, and a blink request that asks to keep the
          current timing before the LED has ever been blinked is declined so
          that the LED core picks the fallback instead.

      delay-off:
        $ref: /schemas/types.yaml#/definitions/uint32
        description: >
          Default blink off-time in milliseconds.  Must be set together with
          delay-on, and both must be non-zero.

          These are the timings this LED is programmed with before it has been
          blinked explicitly.  A blink request of zero for both, which the LED
          core issues to mean "keep the current timing", re-applies these
          rather than changing them.

      led-names:
        description: Deprecated, use label instead.

    # The two child shapes.  Property definitions live above so that
    # unevaluatedProperties can see them; these branches only state which of
    # them a given node must and must not carry.
    oneOf:
      # The keypad sink: no channel index, on/off only.
      - required:
          - mediatek,is-kpled

        not:
          anyOf:
            - required: ["reg"]
            - required: ["mediatek,num-steps"]

      # An ISINK channel: must name its channel index, and is not a keypad
      # sink.
      - required:
          - reg

        not:
          required:
            - mediatek,is-kpled

required:
  - compatible

additionalProperties: false

examples:
  - |
    leds {
      compatible = "mediatek,mt6320-led";

      red {
        reg = <0>;
        mediatek,num-steps = <4>;
        label = "red";
      };

      green {
        reg = <1>;
        mediatek,num-steps = <4>;
        label = "green";
      };

      blue {
        reg = <2>;
        mediatek,num-steps = <4>;
        label = "blue";
      };
    };

  - |
    leds {
      compatible = "mediatek,mt6320-led";

      keypad-backlight {
        label = "button-backlight";
        mediatek,is-kpled;
      };
    };
...
```

## Documentation/devicetree/bindings/media/a5142,mipi.yaml
```yaml
# SPDX-License-Identifier: (GPL-2.0-only OR BSD-2-Clause)
%YAML 1.2
---
$id: http://devicetree.org/schemas/media/i2c/a5142,mipi.yaml#
$schema: http://devicetree.org/schemas/base.yaml#

title: A5142 CMOS Image Sensor

maintainers:
  - Lenovo Linux Team

description: |
  The A5142 is a 5 megapixel RAW CMOS image sensor with a 2-lane MIPI
  CSI-2 output and a separate SCCB control bus.  It is the main (rear)
  camera of the Lenovo YOGA Tablet 8/10, which uses the MediaTek MT6589
  SoC.

  The SCCB bus is I2C compatible and appears on the I2C host bus, so this
  node is a normal I2C device.

properties:
  compatible:
    const: a5142,mipi

  reg:
    description: I2C address of the SCCB interface.
    enum: [0x6c]

  clocks:
    description: |
      The sensor master clock.  The vendor driver programs the sensor PLL
      assuming a 26 MHz CAM_MCLK, so a clock frequency of 26 MHz is
      required.  On MT6589 this is the image subsystem CAM_CAM clock.
    maxItems: 1

  clock-frequency:
    description: Frequency of the SCCB control bus, in Hz.
    default: 100000

  pwdn-gpios:
    description: |
      GPIO connected to the sensor PWDN pin, if any.  Must be asserted
      high to power the sensor down.  The sensor requires 20 ms after
      PWDN rises before the SCCB is accessible.

  reset-gpios:
    description: |
      GPIO connected to the sensor RESET pin, if any.  Must be asserted
      low to hold the sensor in reset.

  vdda-supply:
    description: Regulator for the sensor analogue core (AVDD).

  vddd-supply:
    description: Regulator for the sensor digital core (DVDD).

  vddaaf-supply:
    description: Regulator for the sensor analogue filter (VAF).

  enable-gpios:
    maxItems: 1

  rotation:
    description: Rotation of the sensor relative to the display.
    enum: [0, 90, 180, 270]

  horizontal-flip:
    type: boolean

  vertical-flip:
    type: boolean

  clock-names:
    const:
      items:
        - name
      list:
        - name

required:
  - compatible
  - reg

additionalProperties: false

examples:
  - |
    a5142: camera@6c {
        compatible = "a5142,mipi";
        reg = <0x6c>;

        clocks = <&imgsys CLK_IMAGE_CAM_CAM>;
        clock-frequency = <400000>;

        pwdn-gpios = <&pio 211 GPIO_ACTIVE_HIGH>;
        reset-gpios = <&pio 212 GPIO_ACTIVE_HIGH>;

        vdda-supply = <&mt6320_ldo_vcama>;
        vddd-supply = <&mt6320_ldo_vgp1>;
        vddaaf-supply = <&mt6320_ldo_vgp3>;
    };

...
```

## Documentation/devicetree/bindings/media/i2c/mediatek,fm50af.yaml
```yaml
# SPDX-License-Identifier: (GPL-2.0-only OR BSD-2-Clause)
%YAML 1.2
---
$id: http://devicetree.org/schemas/media/i2c/mediatek,fm50af.yaml#
$schema: http://devicetree.org/meta-schemas/core.yaml#

title: FM50AF voice coil motor

maintainers:
  - Akari Tsuyukusa <akkun11.open@gmail.com>

description: |
  The FM50AF is a 10-bit DAC driving a camera lens voice coil motor, used
  for autofocus.  It has no register address: an I2C transfer carries the
  DAC value directly.

properties:
  compatible:
    const: mediatek,fm50af

  reg:
    maxItems: 1

  powerdown-gpios:
    maxItems: 1
    description:
      Optional power-down line.  The FM50AF on the Lenovo B8000 does not
      use one; the actuator is powered whenever its rail is up.

required:
  - compatible
  - reg

additionalProperties: false

examples:
  - |
    i2c {
        #address-cells = <1>;
        #size-cells = <0>;

        lens@18 {
            compatible = "mediatek,fm50af";
            reg = <0x18>;
        };
    };
```

## Documentation/devicetree/bindings/media/i2c/onnn,a5142.yaml
```yaml
# SPDX-License-Identifier: (GPL-2.0-only OR BSD-2-Clause)
%YAML 1.2
---
$id: http://devicetree.org/schemas/media/i2c/onnn,a5142.yaml#
$schema: http://devicetree.org/meta-schemas/core.yaml#

title: ON Semiconductor A5142 MIPI CSI-2 sensor

maintainers:
  - Akari Tsuyukusa <akkun11.open@gmail.com>

description: |
  The A5142 is an ON Semiconductor (Aptina) 5 megapixel raw CMOS image
  sensor with a MIPI CSI-2 output and an I2C control interface.  It is the
  main camera of the Lenovo YOGA Tablet 8/10 (MT6589).

  Registers are 16-bit addressed.  Most of the vendor's register sequence
  writes 16-bit data and a small part of it writes 8-bit data, so the
  driver carries the transfer width per register rather than assuming one.

  The part has no internal autofocus; the FM50AF voice coil motor is a
  separate I2C device on the same camera module.

properties:
  compatible:
    const: onnn,a5142

  reg:
    maxItems: 1

  clocks:
    maxItems: 1

  clock-names:
    const: extclk

  vdd-supply:
    description:
      Digital core supply.  On the Lenovo YOGA Tablet this is the rail the
      vendor calls VCAMD, wired to MT6320 VGP1.

  vddio-supply:
    description:
      I/O supply, the vendor's VCAMIO.

  reset-gpios:
    description: Reset line, active low.
    maxItems: 1

  port:
    $ref: /schemas/graph.yaml#/$defs/port-base
    unevaluatedProperties: false
    description: |
      Video output port.

    properties:
      endpoint:
        $ref: /schemas/media/video-interfaces.yaml#
        unevaluatedProperties: false

        properties:
          bus-type:
            const: 4
          data-lanes:
            description:
              The vendor register tables program two lanes
              (0x31AE = 0x0202), so exactly two are valid here.
            items:
              - const: 1
              - const: 2
          link-frequencies: true

        required:
          - bus-type
          - data-lanes

required:
  - compatible
  - reg
  - clocks
  - clock-names
  - vdd-supply
  - vddio-supply
  - port

additionalProperties: false

examples:
  - |
    #include <dt-bindings/gpio/gpio.h>

    i2c {
        #address-cells = <1>;
        #size-cells = <0>;

        camera@6c {
            compatible = "onnn,a5142";
            reg = <0x6c>;

            clocks = <&camclk 0>;
            clock-names = "extclk";

            vdd-supply = <&cam_2v8>;
            vddio-supply = <&cam_1v8>;

            reset-gpios = <&pio 211 GPIO_ACTIVE_LOW>;

            port {
                a5142_out: endpoint {
                    remote-endpoint = <&csi2_in>;
                    bus-type = <4>;
                    data-lanes = <1 2>;
                };
            };
        };
    };
...
```

## Documentation/devicetree/bindings/media/i2c/ovti,ov9760.yaml
```yaml
# SPDX-License-Identifier: (GPL-2.0-only OR BSD-2-Clause)
%YAML 1.2
---
$id: http://devicetree.org/schemas/media/i2c/ovti,ov9760.yaml#
$schema: http://devicetree.org/meta-schemas/core.yaml#

title: OmniVision OV9760 MIPI CSI-2 sensor

maintainers:
  - Akari Tsuyukusa <akkun11.open@gmail.com>

description: |
  The OV9760 is an OmniVision 1.2 megapixel raw CMOS image sensor with a
  MIPI CSI-2 output and an I2C control interface.  It is the sub camera of
  the Lenovo YOGA Tablet 8/10 (MT6589), where its lens entry is dummy_lens
  because the module has no autofocus actuator.

  Registers are 16-bit addressed and 8-bit wide.

  Note on the I2C address: the vendor driver probes two write addresses in
  turn, 0x6c and 0x20, and adopts whichever answers with sensor ID 0x9760.
  The strapping on any given board is therefore a board property and must be
  given by reg.

properties:
  compatible:
    const: ovti,ov9760

  reg:
    maxItems: 1

  clocks:
    maxItems: 1

  clock-names:
    const: extclk

  vdd-supply:
    description:
      Digital core supply.

  vddio-supply:
    description:
      I/O supply.

  reset-gpios:
    description: Reset line, active low.
    maxItems: 1

  port:
    $ref: /schemas/graph.yaml#/$defs/port-base
    unevaluatedProperties: false
    description: |
      Video output port.

    properties:
      endpoint:
        $ref: /schemas/media/video-interfaces.yaml#
        unevaluatedProperties: false

        properties:
          bus-type:
            const: 4
          data-lanes:
            description:
              The vendor register tables are built for a single lane,
              matching the "MIPI_1_LANE" note above OV9760MIPIPreview().
            items:
              - const: 1
          link-frequencies: true

        required:
          - bus-type
          - data-lanes

required:
  - compatible
  - reg
  - clocks
  - clock-names
  - vdd-supply
  - vddio-supply
  - port

additionalProperties: false

examples:
  - |
    #include <dt-bindings/gpio/gpio.h>

    i2c {
        #address-cells = <1>;
        #size-cells = <0>;

        camera@6c {
            compatible = "ovti,ov9760";
            reg = <0x6c>;

            clocks = <&camclk 1>;
            clock-names = "extclk";

            vdd-supply = <&cam_2v8>;
            vddio-supply = <&cam_1v8>;

            reset-gpios = <&pio 124 GPIO_ACTIVE_LOW>;

            port {
                ov9760_out: endpoint {
                    remote-endpoint = <&csi2_in>;
                    bus-type = <4>;
                    data-lanes = <1>;
                };
            };
        };
    };
...
```
