## Documentation/devicetree/bindings/media/mediatek,mt6589-cam-graph.yaml
```yaml
# SPDX-License-Identifier: (GPL-2.0-only OR BSD-2-Clause)
%YAML 1.2
---
$id: http://devicetree.org/schemas/media/mediatek,mt6589-cam-graph.yaml#
$schema: http://devicetree.org/schemas/base.yaml#

title: MediaTek MT6589 Camera Media Graph

maintainers:
  - Lenovo Linux Team

description: |
  The MT6589 camera path is a chain of three blocks, each of which is its own
  platform device and its own subdev:

    csi2-rx (MIPI CSI-2 receiver) -> scam (sensor-CAM adaptor) -> cam (ISP)

  The blocks declare "remote-endpoint" properties pointing at each other, but
  that is not enough to build a media graph.  A media graph is a runtime object:
  something has to register the media_device and the v4l2_device, run the
  v4l2_async_notifier that pulls the subdevs into that v4l2_device, and create
  the media_links.

  This binding describes the node that owns all of that.  The driver bound to
  it maps no registers and programs no hardware; it is pure plumbing, and it
  exists because none of the three hardware blocks can own the graph without
  making its own probe order and unbind order decide the whole pipeline.

  One node is expected per camera path.  It waits on one endpoint per block it
  should wait for, and the links between the blocks are derived from the DT
  endpoints by the driver, not listed here.

  "One endpoint per block" is load-bearing, not a convention.  The only thing
  that ever puts a v4l2_async_connection on notifier->waiting_list is an
  endpoint on THIS node, and the only thing that registers a subdev into this
  node's v4l2_device is such a connection matching that subdev.  A block that
  declares no endpoint here never joins v4l2_device->subdevs, and the driver's
  link creation walks only that list -- so the links that touch it are silently
  never created, even when its pads and its "remote-endpoint" properties all
  exist and point at the right peers.

properties:
  compatible:
    const: mediatek,mt6589-cam-graph

  ports:
    description: |
      The blocks this driver should wait for.  Each endpoint names a remote
      endpoint belonging to one of the camera subdevs.

      One endpoint per block in the chain, INCLUDING the last one.  For the
      chain above that is three: seninf_out (the receiver's output), scam_out
      (SCAM's output) and cam_in (CAM's input).

      A remote may sit on either a source or a sink endpoint of its block; the
      match is by fwnode, so both resolve.  Source endpoints read more
      naturally, but the important thing is that a remote is named at all.

      Naming cam_in as scam_out's remote does NOT substitute for an endpoint
      here.  It describes the SCAM -> CAM wiring for link creation, but it
      binds nothing: v4l2_async_find_match() only inspects descriptors taken
      from this node's own endpoints, so cam would stay out of
      v4l2_device->subdevs and the SCAM -> CAM link would never be created.

      An endpoint whose remote does not resolve is not an error.  The driver
      counts what resolved, reports how many at probe, and carries on, so a
      graph_to_sensor endpoint can be declared ahead of the sensor node.

      Note that adding a sensor is not a DT-only change on the sensor side: the
      receiver has no sink endpoint for a sensor to point at (its ports carry
      only seninf_out, port@1) and the MIPI CSI-2 D-PHY between the two is not
      modelled.  Restoring the receiver's seninf_in endpoint and adding a
      graph_to_sensor endpoint here are both required before the sensor ->
      receiver link can exist.
    $ref: /schemas/graph/ports.yaml#

    properties:
      "#address-cells":
        const: 1

      "#size-cells":
        const: 0

required:
  - compatible
  - ports

additionalProperties: false

examples:
  - |
    mtk-cam-graph {
        compatible = "mediatek,mt6589-cam-graph";

        /*
         * Wait for the receiver's output, for SCAM's output and for CAM's
         * input.  None of these endpoints has a peer back on this node, so
         * dtc reports each of them as not bidirectional; that is expected for
         * a graph owner, which owns a media_device and a notifier rather than
         * pads.
         */
        ports {
            graph_to_rx: port@0 {
                graph_to_rx_ep: endpoint {
                    remote-endpoint = <&seninf_out_ep>;
                };
            };

            graph_to_scam: port@1 {
                graph_to_scam_ep: endpoint {
                    remote-endpoint = <&scam_out_ep>;
                };
            };

            graph_to_cam: port@2 {
                graph_to_cam_ep: endpoint {
                    remote-endpoint = <&cam_in_ep>;
                };
            };
        };
    };

...
```

## Documentation/devicetree/bindings/media/mediatek,mt6589-csi2-rx.yaml
```yaml
# SPDX-License-Identifier: (GPL-2.0-only OR BSD-2-Clause)
%YAML 1.2
---
$id: http://devicetree.org/schemas/media/mediatek,mt6589-csi2-rx.yaml#
$schema: http://devicetree.org/schemas/base.yaml#

title: MediaTek MT6589 MIPI CSI-2 Receiver

maintainers:
  - Lenovo Linux Team

description: |
  The MT6589 image subsystem contains two independent MIPI CSI-2 receivers
  (called seninf/csi2 in the vendor sources) in a single register window at
  0x15008000, one per camera port.  Each receiver unpacks the MIPI packets,
  checks their ECC/CRC, and forwards the raw byte stream together with
  frame and line synchronisation to the sensor-CAM (SCAM) block that feeds
  the ISP.

  One DT node describes the window; mediatek,seninf-port selects which of
  the two receivers the node programs.

properties:
  compatible:
    const: mediatek,mt6589-csi2-rx

  reg:
    description: |
      Register window covering what this driver programs: seninf_top at
      0x15008000 and the two csi2 receivers at 0x15008100 and 0x15008180,
      0x200 bytes in total.

      The window must NOT be widened to cover the SCAM blocks at
      0x15008200: those have their own node and their own driver, and two
      platform devices reserving one aperture is a real bug - one of them
      ends up driving the other's registers.  Claim 0x200 and no more.
    maxItems: 1

  mediatek,seninf-port:
    description: |
      Which receiver in the window this node programs.  Port 0 is the
      seninf1/csi2 receiver pair at 0x15008100, port 1 is seninf2/csi2 at
      0x15008180.  On the Lenovo YOGA Tablet 8/10 port 0 is the main (rear)
      camera and port 1 is the front camera.
    enum: [0, 1]
    default: 0

  clocks:
    description: |
      Up to three clocks, in this order:
        seninf - the sensor front end block itself
        csi2   - the CSI-2 receiver sampling logic
        tg_grp - the timing generator feeding the parallel sensor clock

      These are OPTIONAL and the driver treats each one as optional: it takes
      them with devm_clk_get_optional() and, for each gate that is present,
      enables it with clk_prepare_enable() on resume and drops it on suspend.

      They are optional because the gate bits behind these names cannot be
      derived on this SoC.  The MT6589 clock bindings stop at CLK_IMAGE_FPC and
      the data sheet documents SENINF at 0x15008000 but never describes the
      CAM_TG_CG register that the gate bits would live in, so the bit positions
      are unknown.  Rather than guess - a wrong bit could gate off a block
      some other driver is using - the in-tree board leaves the property off
      entirely.

      When a gate is absent the driver simply programs the receiver off
      whatever clock state it finds: it skips the clk_prepare_enable() for
      that gate, still deasserts the reset, still powers the D-PHY up if one
      is wired, and still writes the receiver's registers.  So a node with no
      "clocks" probes and its ports program correctly; add the property once
      the real gate positions have been read from hardware.
    minItems: 3
    maxItems: 3

  clock-names:
    description: |
      Names of the gates in "clocks", in the order listed there.  Both
      properties are optional and must either both be present or both be
      absent.
    items:
      - seninf
      - csi2
      - tg_grp

  phys:
    description: |
      The MIPI CSI-2 D-PHY this receiver sits on top of.  The driver
      initialises and powers it on with the receiver and releases it on
      power-off.  Optional: a node without it still probes, but its lanes
      stay idle.
    maxItems: 1

  phy-names:
    description: Name of the D-PHY reference in "phys".
    const: dphy

  resets:
    maxItems: 1

  reset-names:
    const: seninf

  power-domains:
    maxItems: 1

  # The receiver presents a sink pad facing the sensor (or the MIPI D-PHY
  # that stands in for it) and a source pad facing the SCAM adaptor.
  ports:
    $ref: /schemas/graph/ports.yaml#

    properties:
      "#address-cells":
        const: 1

      "#size-cells":
        const: 0

required:
  - compatible
  - reg
  - mediatek,seninf-port
  - ports

additionalProperties: false

examples:
  - |
    seninf: csi2-rx@15008000 {
        compatible = "mediatek,mt6589-csi2-rx";
        reg = <0x0 0x15008000 0x0 0x200>;

        mediatek,seninf-port = <0>;

        /*
         * No "clocks" / "clock-names" here, and that is deliberate - see the
         * description on "clocks".  The driver takes all three gates as
         * optional and programs the receiver without them.
         */

        resets = <&toprgu MT6589_TOPRGU_IMG_RST>;

        /*
         * Only the source pad is shown, pointing at the SCAM adaptor that
         * follows the receiver; scam_in_ep is defined in the
         * mediatek,mt6589-scam binding.
         *
         * The sink pad is absent because there is nothing in this tree to
         * point it at: the A5142 sensor driver was deleted (it never
         * answered on I2C on this board) and the MIPI CSI-2 D-PHY node went
         * with it, the MT6589 data sheet not describing the PHY registers
         * at all.  The receiver still creates both media pads and it takes
         * a missing "phys" as non-fatal; the link is simply not made.
         */
        ports {
            seninf_out: port@1 {
                seninf_out_ep: endpoint {
                    remote-endpoint = <&scam_in_ep>;
                };
            };
        };
    };

...
```

## Documentation/devicetree/bindings/media/mediatek,mt6589-g2d.yaml
```yaml
# SPDX-License-Identifier: (GPL-2.0-only OR BSD-2-Clause)
%YAML 1.2
---
$id: http://devicetree.org/schemas/media/mediatek,mt6589-g2d.yaml#
$schema: http://devicetree.org/meta-schemas/core.yaml#

title: MediaTek MT6589 2D Accelerator (G2D)

maintainers:
  - Akari Tsuyukusa <akkun11.open@gmail.com>

description: >
  MT6589 contains a 2D graphics accelerator, G2D, that is a separate engine
  from the display pipeline. It has its own MMIO block, its own interrupt, its
  own clock gates, its own DMA master, and its own M4U (IOMMU) port, and it can
  copy or fill rectangles between buffers.

  The block moves pixels between two memory buffers and has nothing to do with
  the display pipeline, so it is a V4L2 memory-to-memory device: a /dev/videoN
  node with an OUTPUT queue (the surface it reads) and a CAPTURE queue (the one
  it writes).  Buffers reach it as dma-buf fds, imported per queue, so the
  addresses it is programmed with are mapped through its own M4U port.  The
  rectangle is described with the standard V4L2 selection API and a fill is the
  same queue pair with a zero-sized COMPOSE selection, so no driver-private
  userspace interface is defined.

  It is not a child of the display subsystem in the bindings sense either: it
  has its own MMIO block, interrupt and clock gates, and the only thing it
  shares with the display blocks is the power domain.

properties:
  compatible:
    enum:
      - mediatek,mt6589-g2d

  reg:
    maxItems: 1

  interrupts:
    maxItems: 1

  clocks:
    minItems: 2
    maxItems: 2

  clock-names:
    items:
      - g2d-engine
      - g2d-smi

  power-domains:
    maxItems: 1

  iommus:
    description: >
      M4U port for the G2D engine's SRC, W2M and DST address registers.
      G2D is a DMA client with its own address registers, so it needs its
      own translation: a dma-buf imported on either queue is mapped through
      this device, and the resulting IOVA is what gets programmed.  The
      driver cannot work without it, because the address it writes into
      SRC_ADDR/W2M_ADDR is meaningful only to the page table of the port
      that produced it.
    maxItems: 1

required:
  - compatible
  - reg
  - interrupts
  - clocks
  - clock-names
  - iommus

additionalProperties: false

examples:
  - |
    g2d: g2d@14013000 {
        compatible = "mediatek,mt6589-g2d";
        reg = <0x14013000 0x1000>;
        interrupts = <GIC_SPI 177 IRQ_TYPE_LEVEL_LOW>;
        clocks = <&dispsys CLK_DISP0_G2D_ENGINE>,
                 <&dispsys CLK_DISP0_G2D_SMI>;
        clock-names = "g2d-engine", "g2d-smi";
        iommus = <&iommu MT6589_M4U_PORT_G2D>;
        power-domains = <&spm MT6589_POWER_DOMAIN_DIS>;
        status = "okay";
    };
```
