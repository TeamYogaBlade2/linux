## Documentation/devicetree/bindings/media/mediatek,mt6589-vdec.yaml
```yaml
# SPDX-License-Identifier: (GPL-2.0-only OR MIT)
%YAML 1.2
---
$id: http://devicetree.org/schemas/mediatek,mt6589-vdec.yaml#
$schema: http://devicetree.org/schemas/bindings.yaml#

title: MediaTek MT6589 Video Decoder (VDEC)

description: |
  The MT6589 video decoder is a hardwired RTL accelerator at 0x16020000 with no
  coprocessor and no firmware, described in data sheet chapter 59 as a
  multi-standard block: MPEG-1/2, MPEG-4, DivX, Xvid, H.263, VC-1, WMV9, H.264 up
  to level 4.2 and VP8.  It is programmed entirely through MMIO and power is a
  plain clock gate in the VDE power domain.

  This node is the decoder half of what was previously one combined
  "mediatek,mt6589-vcodec" node also covering the encoder.  VENC and VDEC are
  separate hardware blocks - separate register window, separate interrupt
  (MT_VDEC_IRQ_ID = GIC SPI 140 against MT_VENC_IRQ_ID = SPI 136), separate clock
  controller and separate power domain - and separating them is what allows each to
  attach its single power domain: genpd_dev_pm_attach() attaches nothing at all
  unless the "power-domains" property has exactly one phandle.

  WHAT THIS NODE DELIVERS, PRECISELY
  -----------------------------------
  A resource layer and an honest V4L2 node.  The node registers, opens, answers
  VIDIOC_QUERYCAP and negotiates formats.  Its device_run() reports -ENODEV for
  every buffer, and that is the correct answer rather than a stub:

  - The vendor stack does not program the VDEC datapath from the kernel.  Its
    kernel driver (videocodec_kernel_driver.c, 2391 lines) touches the decoder only
    to power it up and to acknowledge the frame-end interrupt (:300-301); it never
    writes a datapath register.  The sequence is shipped from CLOSED USERSPACE as a
    queue of WRITE_REG_CMD records (hal_api.h:33-41, :107-124) that the driver
    merely walks over the MFV_SET_CMD_CMD ioctl:

        case WRITE_REG_CMD:
            VDO_HW_WRITE(cmd_queue->address + cmd_queue->offset,
                         cmd_queue->value);   (videocodec_kernel_driver.c:1758)

    The decode sequence therefore lives in stripped, partly encrypted ARM blobs
    (libvp8dec_sa.ca7.so and siblings).  Porting it is a userspace
    reverse-engineering project, not a kernel one.
  - The data sheet has no register-definition section for this block at all:
    chapter 59 stops at the block diagram, and "16000000" does not appear anywhere
    in it.  The only readable register map is the vendor LDVT register-test
    harness, which sets CONFIG_CHIP_VER_CURR 80 (include/vdec_info_common.h:125) -
    that same header defines 80 as MT8580 (:130), a different SoC.
  - VP8 additionally requires its probability tables pushed bit-by-bit into parser
    SRAM before any frame can decode.

  Having its own driver, its own power domain and its own node does not change any
  of that.  Userspace of this driver must not expect a decoded picture.

maintainers:
  - Akari Tsuyukusa <akkun11.open@gmail.com>

properties:
  compatible:
    oneOf:
      - items:
          - const: mediatek,mt6589-vdec

  reg:
    maxItems: 1
    description: |
      The decoder register window: 0x29000 bytes at 0x16020000, itself split into
      a MISC block at offset 0 and a VLD (bitstream parser) block at offset 0x1000.

      Note this is 0x16020000 and NOT 0x16000000, which is the vdecsys clock
      controller.  It comes from the stock mt_reg_base.h VDEC_BASE 0xF6020000
      after the +0xE0000000 remap.  A binding cannot describe the register layout,
      because no register definition for this block exists in the data sheet.

  interrupts:
    maxItems: 1
    description: |
      One interrupt line: MT_VDEC_IRQ_ID = GIC_PRIVATE_SIGNALS(32) + 140 = SPI 140
      (kernel/core/include/mach/mt_irq.h:103).

      It is asserted HIGH.  The vendor driver registers it with
      IRQF_TRIGGER_HIGH (videocodec_kernel_driver.c:2113), the opposite polarity to
      the encoder's, so IRQ_TYPE_LEVEL_LOW here would silently never fire.

  clocks:
    minItems: 2
    maxItems: 2
    description: |
      Two clock gates from the vdecsys provider: the decoder engine (MT_CG_VDEC0_VDE
      / CLK_VDEC0_VDE) and its SMI/LARB clock (MT_CG_VDEC1_SMI / CLK_VDEC1_SMI).

  clock-names:
    items:
      - const: vdec-vde
      - const: vdec-smi
    description: |
      Required rather than implied: vencsys and vdecsys each number their gates
      from zero, so provider-local clock ids are not a unique key and index-based
      lookup cannot tell the providers apart.

  power-domains:
    maxItems: 1
    description: |
      The decoder power domain, VDE.  It arrives powered off at reset (PWR_STATUS
      bit 8 is 0) and has to be raised by the SCM power sequence.

      This property must name exactly ONE domain.  genpd_dev_pm_attach() attaches
      a domain only when the phandle count is exactly 1 (drivers/pmdomain/core.c),
      so a node naming two domains gets no domain at all and no deferred probe -
      which is why this block is a node of its own rather than a second window in
      a combined node.

  iommus:
    minItems: 1
    items:
      description: |
        M4U port for a decoder DMA engine.  All of the decoder's ports are on
        larb1, and they must be: mtk_iommu_v1_probe_device() rejects a device
        whose master ids span two larbs.

required:
  - compatible
  - reg
  - interrupts
  - clocks
  - clock-names
  - power-domains

additionalProperties: false
```

## Documentation/devicetree/bindings/media/mediatek,mt6589-venc.yaml
```yaml
# SPDX-License-Identifier: (GPL-2.0-only OR MIT)
%YAML 1.2
---
$id: http://devicetree.org/schemas/mediatek,mt6589-venc.yaml#
$schema: http://devicetree.org/schemas/bindings.yaml#

title: MediaTek MT6589 H.264/VP8 Video Encoder (VENC)

description: |
  The MT6589 video encoder is a hardwired RTL accelerator at 0x17002000 with no
  coprocessor and no firmware, described in data sheet chapter 60 (H.264/VP8) and
  chapter 61 (MPEG-4, inside the same window).  Unlike the later MediaTek VPU/IPI
  generations, the block is programmed entirely through MMIO and power is a plain
  clock gate in the VEN power domain.

  This node is the encoder half of what was previously one combined
  "mediatek,mt6589-vcodec" node also covering the decoder.  VENC and VDEC are
  separate hardware blocks - separate register window, separate interrupt
  (MT_VENC_IRQ_ID = GIC SPI 136 against MT_VDEC_IRQ_ID = SPI 140), separate clock
  controller and separate power domain - and separating them is what allows each to
  attach its single power domain: genpd_dev_pm_attach() attaches nothing at all
  unless the "power-domains" property has exactly one phandle.

  DRAFT DRIVER - SCOPE OF WHAT ACTUALLY WORKS
  ------------------------------------------
  This driver implements the chapter-60 H.264 datapath.  Read this before assuming
  a conformant codec is present.

  What it does do:

  - Probes the register window, the VENC clock and the encoder interrupt.
  - Brings the engine out of reset and gates its clock through runtime PM.
  - Programs the H.264 datapath: the bitstream, source, reference and
    reconstruction address registers, and the quantiser triple, target bit rate,
    CBR/initial-QP mode bits, frame rate and P/B QP adjust limiters, rejecting
    quantisers outside the documented 0..51 range.
  - Allocates and owns the bitstream, reference, reconstruction and rate control
    scratch buffers those address registers need.  The reference and
    reconstruction planes are a two-buffer ping-pong within one coherent
    allocation of frame_size * 3 / 2 per buffer, with frame_size remaining the
    luma size because it is also the chroma offset.
  - Acknowledges the encoder frame-done interrupt, handles a bitstream-buffer
    overflow, and reports the coded bitstream length; a watchdog
    (MTK_VENC_TIMEOUT_MS) retires a frame the hardware never completes, so a
    wedged engine cannot pin a clock reference forever.
  - Exposes the H.264 datapath as a V4L2 memory-to-memory codec node (NV12 in,
    bitstream out).

  What it does NOT do:

  - Conformant bitstreams.  Entropy coding, motion estimation and the coefficient
    buffer exist only in the vendor's closed userspace libraries and were not
    ported, and the bitrate algorithm behind the rate control registers is the
    vendor's.  The registers are programmed; the codec is not implemented.
    Userspace must treat the output as opaque.
  - Slice control (a frame larger than one MB row is never split into slices),
    and SPS/PPS emission (no parameter-set buffer is allocated).
  - MPEG-4 encoding: its address programming and interrupt exist, but the three
    chroma planes and the per-MB side-information buffer at VENC_MP4_SIDE_ADDR
    are not allocated, so a submit is rejected with -ENODEV.
  - VP8 beyond what mtk_venc_bitstream_size() restricts it to.

  There is no hardware to test against, so none of this is claimed to work end
  to end.

  Status: the node in arch/arm/boot/dts/mediatek/mt6589-vcodec.dtsi is disabled,
  because the VEN power-on is undiagnosed.  See
  drivers/pmdomain/mediatek/mt6589-power-domains.md.

maintainers:
  - Akari Tsuyukusa <akkun11.open@gmail.com>

properties:
  compatible:
    oneOf:
      - items:
          - const: mediatek,mt6589-venc

  reg:
    maxItems: 1
    description: |
      The encoder register window: 4 KiB at 0x17002000, documented twice over as
      data sheet chapter 60 (H.264 and VP8) and chapter 61 (MPEG-4, starting at
      offset 0x600 inside the same window).

  interrupts:
    maxItems: 1
    description: |
      One interrupt line: MT_VENC_IRQ_ID = GIC_PRIVATE_SIGNALS(32) + 136 = SPI 136
      (kernel/core/include/mach/mt_irq.h:101).

      It is asserted LOW.  The vendor driver registers it with IRQF_TRIGGER_LOW
      (videocodec_kernel_driver.c:2104), and the decoder's line is the opposite
      polarity, so IRQ_TYPE_LEVEL_HIGH here would silently never fire.

  clocks:
    maxItems: 1
    description: |
      One clock gate: the encoder engine, CLK_VENC_VEN from the vencsys provider.

  clock-names:
    items:
      - const: venc
    description: |
      Required rather than implied.  vencsys and vdecsys each number their gates
      from zero, so the provider-local clock ids are not a unique key and
      index-based lookup cannot tell the two providers apart.

  power-domains:
    maxItems: 1
    description: |
      The encoder power domain, VEN.  It arrives powered off at reset (PWR_STATUS
      bit 7 is 0) and has to be raised by the SCM power sequence.

      This property must name exactly ONE domain.  genpd_dev_pm_attach() attaches
      a domain only when the phandle count is exactly 1 (drivers/pmdomain/core.c),
      so a node naming two domains gets no domain at all and no deferred probe -
      which is why this block is a node of its own rather than a second window in
      a combined node.

  iommus:
    minItems: 1
    items:
      description: |
        M4U port for an encoder DMA engine.  All of the encoder's ports are on
        larb0, and they must be: mtk_iommu_v1_probe_device() rejects a device
        whose master ids span two larbs.

required:
  - compatible
  - reg
  - interrupts
  - clocks
  - clock-names
  - power-domains

additionalProperties: false
```

## Documentation/devicetree/bindings/memory-controllers/mediatek,mt6589-dramc.yaml
```yaml
# SPDX-License-Identifier: (GPL-2.0-only OR BSD-2-Clause)
%YAML 1.2
---
$id: http://devicetree.org/schemas/memory-controllers/mediatek,mt6589-dramc.yaml#
$schema: http://devicetree.org/meta-schemas/core.yaml#

title: MediaTek MT6589 DRAM controller and DDR PHY

maintainers:
  - Akari Tsuyukusa <akkun11.open@gmail.com>

description: |
  The MT6589 DRAM controller is deliberately split across three register
  windows, which the datasheet names in its DRAMC chapter:

    DRAMC AO   base +0x1000_4000  - timings, configuration, MRS
    DRAMC NAO  base +0x1020_F000  - always-on bank counters
    DDRPHY     base +0x1001_1000  - pad and DLL controls, and MEMPLL

  Downstream agrees exactly (mt_reg_base.h: DRAMC0_BASE 0xF0004000,
  DDRPHY_BASE 0xF0011000, DRAMC_NAO_BASE 0xF020F000) and its accessors
  deliberately OR and write all three windows at the same offset, which
  makes a register that is only implemented in one of them look present in
  all three.  This binding lists them separately so a driver can say which
  window a value came from.

  The driver is read-only and takes the DDRPHY window only for the
  controls it reads - it does not claim the MEMPLL registers at 0x600.. of
  that window, which belong to the "mediatek,mt6589-mempll" clock node.
  The two nodes therefore both reference 0x1001_1000 but map separate reg
  entries, so neither takes ownership of the other's registers.

properties:
  compatible:
    const: mediatek,mt6589-dramc

  reg:
    minItems: 1
    maxItems: 3
    description: |
      The DRAMC AO window at 0x1000_4000 is required and comes first.
      Optionally followed by the NAO window at 0x1020_F000 and the DDRPHY
      window at 0x1001_1000, in that order.

  reg-names:
    minItems: 1
    items:
      - const: ao
      - const: nao
      - const: ddrphy

  clocks:
    maxItems: 1
    description: The DRAM clock, MEMPLL_MCK_D4.  Informational only.

  clock-names:
    const: ddr

  mediatek,emi:
    $ref: /schemas/types.yaml#/definitions/phandle
    description: |
      Phandle to the EMI node, from which the address-mapping register
      EMI_CONA is read to derive the DRAM geometry.  Optional: without it
      the timing registers are still reported, but the size and geometry
      cannot be derived.

required:
  - compatible
  - reg

additionalProperties: false

examples:
  - |
    #include <dt-bindings/clock/mediatek,mt6589-clk.h>

    dramc: memory-controller@10004000 {
        compatible = "mediatek,mt6589-dramc";
        reg = <0x10004000 0x1000>,
              <0x1020f000 0x1000>,
              <0x10011000 0x1000>;
        reg-names = "ao", "nao", "ddrphy";
        clocks = <&topckgen CLK_TOP_MEMPLL_MCK_D4>;
        clock-names = "ddr";
    };
```
