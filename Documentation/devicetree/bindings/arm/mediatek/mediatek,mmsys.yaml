## Documentation/devicetree/bindings/gpu/img,powervr-sgx.yaml
```yaml
# SPDX-License-Identifier: (GPL-2.0-only OR BSD-2-Clause)
# Copyright (c) 2023 Imagination Technologies Ltd.
# Copyright (C) 2024 Texas Instruments Incorporated - https://www.ti.com/
%YAML 1.2
---
$id: http://devicetree.org/schemas/gpu/img,powervr-sgx.yaml#
$schema: http://devicetree.org/meta-schemas/core.yaml#

title: Imagination Technologies PowerVR SGX GPUs

maintainers:
  - Frank Binns <frank.binns@imgtec.com>

properties:
  compatible:
    oneOf:
      - items:
          - enum:
              - ti,omap3430-gpu # Rev 121
              - ti,omap3630-gpu # Rev 125
          - const: img,powervr-sgx530
      - items:
          - enum:
              - ingenic,jz4780-gpu # Rev 130
              - ti,omap4430-gpu # Rev 120
          - const: img,powervr-sgx540
      - items:
          - enum:
              - allwinner,sun6i-a31-gpu # MP2 Rev 115
              - mediatek,mt6589-gpu # MP1 Rev 115
              - ti,omap4470-gpu # MP1 Rev 112
              - ti,omap5432-gpu # MP2 Rev 105
              - ti,am5728-gpu # MP2 Rev 116
              - ti,am6548-gpu # MP1 Rev 117
          - const: img,powervr-sgx544

  reg:
    maxItems: 1

  interrupts:
    maxItems: 1

  clocks:
    minItems: 1
    maxItems: 4

  clock-names:
    minItems: 1
    items:
      - const: core
      - const: mem
      - const: sys
      - const: hyd

  operating-points-v2: true

  nvmem-cells:
    minItems: 1
    maxItems: 2

  nvmem-cell-names:
    minItems: 1
    items:
      - const: gpu_grade      # MT6589: devinfo[3] bits[30:28], speed grade
      - const: gpu_sw_efuse   # MT6589: devinfo[10] bit 7, forces 238.333 MHz

  firmware-name:
    $ref: /schemas/types.yaml#/definitions/string
    description:
      uKernel firmware file name (default depends on the SoC); the register
      init script is loaded from the same directory with the "-ukernel.bin"
      suffix replaced by "-init.bin".

  vrf18_2-supply:
    description: Regulator feeding the GPU (MT6589 VRF18_2 buck, DVFS rail).

  power-domains:
    maxItems: 1

  resets:
    maxItems: 1

  reset-names:
    items:
      - const: g3d

required:
  - compatible
  - reg
  - interrupts

allOf:
  # A power domain exists (and is then mandatory) on these SoCs only.
  - if:
      properties:
        compatible:
          contains:
            enum:
              - ti,am6548-gpu
              - mediatek,mt6589-gpu
    then:
      required:
        - power-domains
    else:
      properties:
        power-domains: false
  # Clocks are described in DT on these SoCs only.
  - if:
      properties:
        compatible:
          contains:
            enum:
              - allwinner,sun6i-a31-gpu
              - ingenic,jz4780-gpu
              - mediatek,mt6589-gpu
    then:
      required:
        - clocks
        - clock-names
    else:
      properties:
        clocks: false
        clock-names: false
  - if:
      properties:
        compatible:
          contains:
            const: mediatek,mt6589-gpu
    then:
      required:
        - resets
        - reset-names
      properties:
        clocks:
          minItems: 4
        clock-names:
          minItems: 4
    else:
      properties:
        resets: false
        reset-names: false
        nvmem-cells: false
        nvmem-cell-names: false
        vrf18_2-supply: false
  - if:
      properties:
        compatible:
          contains:
            const: allwinner,sun6i-a31-gpu
    then:
      properties:
        clocks:
          minItems: 2
          maxItems: 2
        clock-names:
          minItems: 2
          maxItems: 2
  - if:
      properties:
        compatible:
          contains:
            const: ingenic,jz4780-gpu
    then:
      properties:
        clocks:
          maxItems: 1
        clock-names:
          maxItems: 1

additionalProperties: false

examples:
  - |
    #include <dt-bindings/interrupt-controller/irq.h>
    #include <dt-bindings/interrupt-controller/arm-gic.h>
    #include <dt-bindings/soc/ti,sci_pm_domain.h>

    gpu@7000000 {
        compatible = "ti,am6548-gpu", "img,powervr-sgx544";
        reg = <0x7000000 0x10000>;
        interrupts = <GIC_SPI 162 IRQ_TYPE_LEVEL_HIGH>;
        power-domains = <&k3_pds 65 TI_SCI_PD_EXCLUSIVE>;
    };

  - |
    #include <dt-bindings/interrupt-controller/irq.h>
    #include <dt-bindings/interrupt-controller/arm-gic.h>

    gpu: gpu@1c40000 {
        compatible = "allwinner,sun6i-a31-gpu", "img,powervr-sgx544";
        reg = <0x01c40000 0x10000>;
        interrupts = <GIC_SPI 97 IRQ_TYPE_LEVEL_HIGH>;
        clocks = <&ccu 1>, <&ccu 2>;
        clock-names = "core", "mem";
    };
```

## Documentation/devicetree/bindings/gpu/mediatek,mt6589-g2d.yaml
```yaml
# SPDX-License-Identifier: (GPL-2.0-only OR BSD-2-Clause)
%YAML 1.2
---
$id: http://devicetree.org/schemas/gpu/mediatek,mt6589-g2d.yaml#
$schema: http://devicetree.org/meta-schemas/core.yaml#

title: MediaTek MT6589 2D Accelerator (G2D)

maintainers:
  - Akari Tsuyukusa <akkun11.open@gmail.com>

description: >
  MT6589 contains a 2D graphics accelerator, G2D, that is a separate engine
  from the display pipeline. It has its own MMIO block, its own interrupt, its
  own clock gates, its own DMA master, and its own M4U (IOMMU) port, and it can
  copy or fill rectangles between buffers.

  It is driven as its own DRM render node rather than as part of the display
  DRM device, because it is not a display-pipeline sub-block. Sharing the
  display device's DRM GEM namespace would force both engines to use one DMA
  address space, which only works while the M4U bypasses the port.

  Buffers are shared with the display pipeline through dma-buf. The display
  device exports a GEM handle with PRIME_HANDLE_TO_FD and this driver imports
  it with PRIME_FD_TO_HANDLE, so each engine maps the buffer in its own DMA
  address space.

properties:
  compatible:
    enum:
      - mediatek,mt6589-g2d

  reg:
    maxItems: 1

  interrupts:
    maxItems: 1

  clocks:
    minItems: 2
    maxItems: 2

  clock-names:
    items:
      - engine
      - smi

  power-domains:
    maxItems: 1

  iommus:
    description: >
      M4U port for the G2D engine's SRC, W2M and DST address registers.
      G2D is a DMA client with its own address registers, so it needs its
      own translation: the driver makes this platform device the DRM
      device's dma_dev and allocates GEM memory against it, so a GEM
      dma_addr is an IOVA this engine can be handed.  The driver cannot
      work without it, because it programs addresses produced by that
      device and no other.
    maxItems: 1

required:
  - compatible
  - reg
  - interrupts
  - clocks
  - clock-names
  - iommus

additionalProperties: false

examples:
  - |
    g2d: g2d@14013000 {
        compatible = "mediatek,mt6589-g2d";
        reg = <0x14013000 0x1000>;
        interrupts = <GIC_SPI 177 IRQ_TYPE_LEVEL_LOW>;
        clocks = <&dispsys CLK_DISP0_G2D_ENGINE>,
                 <&dispsys CLK_DISP0_G2D_SMI>;
        clock-names = "engine", "smi";
        iommus = <&iommu MT6589_M4U_PORT_G2D>;
        power-domains = <&spm MT6589_POWER_DOMAIN_DIS>;
        status = "okay";
    };
```

## Documentation/devicetree/bindings/iio/adc/mediatek,mt6323-auxadc.yaml
```yaml
# SPDX-License-Identifier: (GPL-2.0-only OR BSD-2-Clause)
%YAML 1.2
---
$id: http://devicetree.org/schemas/iio/adc/mediatek,mt6323-auxadc.yaml#
$schema: http://devicetree.org/meta-schemas/core.yaml#

title: MediaTek MT6320 and MT6323 PMIC Auxiliary ADC

maintainers:
  - Flora Fu <flora.fu@mediatek.com>

description: |
  AUXADC is the auxiliary ADC of the PMIC, used for sampling a variety
  of channels like battery voltage, PMIC internal temperature, accessory
  detection resistance, and other internal components.

properties:
  compatible:
    enum:
      - mediatek,mt6320-auxadc
      - mediatek,mt6323-auxadc

  "#io-channel-cells":
    const: 1

required:
  - compatible
  - "#io-channel-cells"

additionalProperties: false

examples:
  - |
    pmic {
        #address-cells = <1>;
        #size-cells = <0>;

        adc {
            compatible = "mediatek,mt6323-auxadc";
            #io-channel-cells = <1>;
        };
    };
```

## Documentation/devicetree/bindings/iio/light/dynaimage,al3320a.yaml
```yaml
# SPDX-License-Identifier: (GPL-2.0-only OR BSD-2-Clause)
%YAML 1.2
---
$id: http://devicetree.org/schemas/iio/light/dynaimage,al3320a.yaml#
$schema: http://devicetree.org/meta-schemas/core.yaml#

title: Dyna-Image AL3320A and AL3320B sensors

maintainers:
  - David Heidelberg <david@ixit.cz>

properties:
  compatible:
    enum:
      - dynaimage,al3320a
      - dynaimage,al3320b

  reg:
    maxItems: 1

  interrupts:
    maxItems: 1

  vdd-supply:
    description: Regulator that provides power to the sensor

required:
  - compatible
  - reg

additionalProperties: false

examples:
  - |
    #include <dt-bindings/interrupt-controller/irq.h>

    i2c {
        #address-cells = <1>;
        #size-cells = <0>;

        light-sensor@1c {
            compatible = "dynaimage,al3320a";
            reg = <0x1c>;
            vdd-supply = <&vdd_reg>;
            interrupts = <99 IRQ_TYPE_LEVEL_HIGH>;
        };
    };

  - |
    i2c {
        #address-cells = <1>;
        #size-cells = <0>;

        light-sensor@1c {
            compatible = "dynaimage,al3320b";
            reg = <0x1c>;
            vdd-supply = <&vdd_reg>;
        };
    };
```

## Documentation/devicetree/bindings/input/mediatek,mt6320-vibrator.yaml
```yaml
# SPDX-License-Identifier: (GPL-2.0 OR BSD-2-Clause)
%YAML 1.2
---
$id: http://devicetree.org/schemas/input/mediatek,mt6320-vibrator.yaml#
$schema: http://devicetree.org/meta-schemas/core.yaml#

title: MediaTek MT6320 PMIC Vibrator

maintainers:
  - Akari Tsuyukusa <akkun11.open@gmail.com>

allOf:
  - $ref: leds.yaml#

description: |
  The MT6320 PMIC, used by MediaTek MT6589 SoCs, drives a linear resonant
  actuator through an integrated LDO called VIBR. The part has no separate
  amplifier enable pin and no PWM duty input: the rail is gated by RG_VIBR_EN
  in DIGLDO_CON39, and the vibration amplitude is the LDO output voltage
  selected by RG_VIBR_VOSEL in DIGLDO_CON40.

  The eight selectable output voltages are 1200, 1300, 1500, 1800, 2500,
  2800, 3000 and 3300 mV. Any request is rounded down to the nearest of
  these, and the vendor default of 2800 mV is used when no amplitude is
  given.

  The vibrator is exposed as an LED classdev so that userspace can set a
  brightness (which plays a single pulse) or a one-interval LED pattern.
  Because the rail is gated by the VIBR regulator, the regulator node
  supplying this device must be the PMIC's own "vibr" LDO.

properties:
  compatible:
    const: mediatek,mt6320-vibrator

  vibr-supply:
    description: |
      Regulator providing the vibrator LDO. On the MT6320 this must be the
      PMIC's own VIBR LDO, since the driver relies on the regulator owning
      the RG_VIBR_EN gate.
    $ref: /schemas/types.yaml#/definitions/phandle

  mediatek,vibr-amplitude-uv:
    description: |
      Vibrator output voltage in microvolts. This is the vibration
      amplitude: on a linear resonant actuator a higher LDO voltage yields a
      stronger drive. The value is clamped to the nearest hardware setting
      of 1200000, 1300000, 1500000, 1800000, 2500000, 2800000, 3000000 or
      3300000 microvolts.
    $ref: /schemas/types.yaml#/definitions/int
    default: 2800000
    minimum: 1200000
    maximum: 3300000

required:
  - compatible

additionalProperties: false

...
```
